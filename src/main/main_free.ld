/* ================================================================
 * main_free.ld  --  Free-layout linker script for main
 *
 * Functions can change size without breaking the binary.
 * __pad_size shifts all FUN_ addresses to validate relocation.
 *
 * Usage:
 *   make validate-free          # zero-shift, byte-identical
 *   make disc-4shift            # +4 shift boot test
 *
 * Generated by gen_free_ld.py from main_symbols.json
 * ================================================================ */

OUTPUT_FORMAT("elf32-sh")
OUTPUT_ARCH(sh)
ENTRY(FUN_00280000)

/* Default: no padding. Override with --defsym __pad_size=N */
PROVIDE(__pad_size = 0);

SECTIONS
{
    . = 0x00280000;

    /* Pin entry function at module base so boot code can find it. */
    /* It stays at the original address; its pool refs resolve to */
    /* shifted targets, so the jump lands in the right place.      */
    .entry : { *(.text.FUN_00280000) }

    .text : {
        . = . + __pad_size;
        *(SORT_BY_NAME(.text.FUN_*))
    }

    /DISCARD/ : {
        *(.comment)
        *(.note*)
        *(.eh_frame)
    }
}

/* DAT_ symbols: within-binary data, relative to nearest function (425) */
PROVIDE(DAT_00280050 = FUN_00280018 + 0x38);
PROVIDE(DAT_00280158 = FUN_00280100 + 0x58);
PROVIDE(DAT_0028020C = FUN_002801EC + 0x20);
PROVIDE(DAT_002802A0 = FUN_00280214 + 0x8C);
PROVIDE(DAT_002803C0 = FUN_002802A6 + 0x11A);
PROVIDE(DAT_00280550 = FUN_002803C8 + 0x188);
PROVIDE(DAT_0028055C = FUN_002803C8 + 0x194);
PROVIDE(DAT_0028062C = FUN_002805F8 + 0x34);
PROVIDE(DAT_00280670 = FUN_0028062E + 0x42);
PROVIDE(DAT_002806B4 = FUN_00280672 + 0x42);
PROVIDE(DAT_002807B0 = FUN_0028079C + 0x14);
PROVIDE(DAT_002807C0 = FUN_0028079C + 0x24);
PROVIDE(DAT_00280874 = FUN_0028085C + 0x18);
PROVIDE(DAT_0028090C = FUN_00280876 + 0x96);
PROVIDE(DAT_00280970 = FUN_00280910 + 0x60);
PROVIDE(DAT_002809D8 = FUN_00280974 + 0x64);
PROVIDE(DAT_00280A18 = FUN_002809DA + 0x3E);
PROVIDE(DAT_00280A84 = FUN_00280A24 + 0x60);
PROVIDE(DAT_00280B6C = FUN_00280A8C + 0xE0);
PROVIDE(DAT_00280C14 = FUN_00280B70 + 0xA4);
PROVIDE(DAT_00280C7C = FUN_00280C16 + 0x66);
PROVIDE(DAT_00280D4C = FUN_00280CE2 + 0x6A);
PROVIDE(DAT_00280E40 = FUN_00280DC8 + 0x78);
PROVIDE(DAT_00280EF4 = FUN_00280E46 + 0xAE);
PROVIDE(DAT_00280F2C = FUN_00280EF6 + 0x36);
PROVIDE(DAT_00280FE0 = FUN_00280F34 + 0xAC);
PROVIDE(DAT_002810E0 = FUN_00281086 + 0x5A);
PROVIDE(DAT_00281138 = FUN_002810FC + 0x3C);
PROVIDE(DAT_002811D4 = FUN_002811AC + 0x28);
PROVIDE(DAT_00281298 = FUN_002811DC + 0xBC);
PROVIDE(DAT_00281334 = FUN_0028129C + 0x98);
PROVIDE(DAT_002813DC = FUN_0028134E + 0x8E);
PROVIDE(DAT_002814E8 = FUN_0028143E + 0xAA);
PROVIDE(DAT_00281604 = FUN_0028159A + 0x6A);
PROVIDE(DAT_00281680 = FUN_00281634 + 0x4C);
PROVIDE(DAT_002816B0 = FUN_00281682 + 0x2E);
PROVIDE(DAT_002818C4 = FUN_00281876 + 0x4E);
PROVIDE(DAT_00281B28 = FUN_00281B00 + 0x28);
PROVIDE(DAT_00281C34 = FUN_00281C00 + 0x34);
PROVIDE(DAT_00281CD8 = FUN_00281C38 + 0xA0);
PROVIDE(DAT_00281D94 = FUN_00281D88 + 0xC);
PROVIDE(DAT_00281E18 = FUN_00281D9C + 0x7C);
PROVIDE(DAT_00281ED8 = FUN_00281E98 + 0x40);
PROVIDE(DAT_00281F70 = FUN_00281F14 + 0x5C);
PROVIDE(DAT_00281FC0 = FUN_00281F76 + 0x4A);
PROVIDE(DAT_00281FC8 = FUN_00281F76 + 0x52);
PROVIDE(DAT_0028208C = FUN_00281FD0 + 0xBC);
PROVIDE(DAT_00282188 = FUN_00282090 + 0xF8);
PROVIDE(DAT_00282210 = FUN_0028218E + 0x82);
PROVIDE(DAT_002822B8 = FUN_00282216 + 0xA2);
PROVIDE(DAT_002823B4 = FUN_0028235E + 0x56);
PROVIDE(DAT_002823F4 = FUN_002823B6 + 0x3E);
PROVIDE(DAT_00282458 = FUN_002823F8 + 0x60);
PROVIDE(DAT_002824A0 = FUN_00282494 + 0xC);
PROVIDE(DAT_002824F4 = FUN_002824AC + 0x48);
PROVIDE(DAT_00282568 = FUN_002824F6 + 0x72);
PROVIDE(DAT_00282608 = FUN_0028256C + 0x9C);
PROVIDE(DAT_00282750 = FUN_00282612 + 0x13E);
PROVIDE(DAT_00282794 = FUN_00282754 + 0x40);
PROVIDE(DAT_00282808 = FUN_00282798 + 0x70);
PROVIDE(DAT_0028295C = FUN_00282810 + 0x14C);
PROVIDE(DAT_002829FC = FUN_00282966 + 0x96);
PROVIDE(DAT_00282A74 = FUN_00282A5C + 0x18);
PROVIDE(DAT_00282B10 = FUN_00282A7A + 0x96);
PROVIDE(DAT_00282B64 = FUN_00282B14 + 0x50);
PROVIDE(DAT_00282C38 = FUN_00282BFC + 0x3C);
PROVIDE(DAT_00282CF8 = FUN_00282C3E + 0xBA);
PROVIDE(DAT_00282E3C = FUN_00282D04 + 0x138);
PROVIDE(DAT_00282EB0 = FUN_00282E54 + 0x5C);
PROVIDE(DAT_00282F50 = FUN_00282F38 + 0x18);
PROVIDE(DAT_00282F80 = FUN_00282F68 + 0x18);
PROVIDE(DAT_00282FF4 = FUN_00282F84 + 0x70);
PROVIDE(DAT_00283078 = FUN_00283000 + 0x78);
PROVIDE(DAT_0028314C = FUN_00283124 + 0x28);
PROVIDE(DAT_0028320C = FUN_00283158 + 0xB4);
PROVIDE(DAT_00283238 = FUN_0028320E + 0x2A);
PROVIDE(DAT_00283264 = FUN_0028323A + 0x2A);
PROVIDE(DAT_002832B8 = FUN_0028326C + 0x4C);
PROVIDE(DAT_00283304 = FUN_002832BE + 0x46);
PROVIDE(DAT_0028332C = FUN_00283306 + 0x26);
PROVIDE(DAT_002833A8 = FUN_00283334 + 0x74);
PROVIDE(DAT_002833AC = FUN_00283334 + 0x78);
PROVIDE(DAT_002833B0 = FUN_00283334 + 0x7C);
PROVIDE(DAT_00283764 = FUN_00283728 + 0x3C);
PROVIDE(DAT_00283794 = FUN_00283728 + 0x6C);
PROVIDE(DAT_00283868 = FUN_0028385C + 0xC);
PROVIDE(DAT_00283920 = FUN_00283874 + 0xAC);
PROVIDE(DAT_002839A4 = FUN_0028392A + 0x7A);
PROVIDE(DAT_00283A1C = FUN_002839A8 + 0x74);
PROVIDE(DAT_00283B24 = FUN_00283A24 + 0x100);
PROVIDE(DAT_00283BAC = FUN_00283B2A + 0x82);
PROVIDE(DAT_00283C14 = FUN_00283C08 + 0xC);
PROVIDE(DAT_00283CF0 = FUN_00283CE4 + 0xC);
PROVIDE(DAT_00283F88 = FUN_00283F18 + 0x70);
PROVIDE(DAT_002841AC = FUN_00284198 + 0x14);
PROVIDE(DAT_002842B4 = FUN_002842A8 + 0xC);
PROVIDE(DAT_002843D4 = FUN_002842BC + 0x118);
PROVIDE(DAT_002843FC = FUN_002843D6 + 0x26);
PROVIDE(DAT_002845A4 = FUN_00284554 + 0x50);
PROVIDE(DAT_002846A0 = FUN_002845AE + 0xF2);
PROVIDE(DAT_002847C4 = FUN_002847B8 + 0xC);
PROVIDE(DAT_0028485C = FUN_00284828 + 0x34);
PROVIDE(DAT_002848E0 = FUN_002848B4 + 0x2C);
PROVIDE(DAT_00284AE4 = FUN_002848E8 + 0x1FC);
PROVIDE(DAT_00284B84 = FUN_00284B50 + 0x34);
PROVIDE(DAT_00284C28 = FUN_00284B8A + 0x9E);
PROVIDE(DAT_00284CE0 = FUN_00284CBC + 0x24);
PROVIDE(DAT_00284E44 = FUN_00284DEC + 0x58);
PROVIDE(DAT_00284EA4 = FUN_00284E46 + 0x5E);
PROVIDE(DAT_00284F68 = FUN_00284F0C + 0x5C);
PROVIDE(DAT_00285038 = FUN_00285008 + 0x30);
PROVIDE(DAT_002850EC = FUN_0028503C + 0xB0);
PROVIDE(DAT_00285374 = FUN_0028528C + 0xE8);
PROVIDE(DAT_00285488 = FUN_00285450 + 0x38);
PROVIDE(DAT_0028569C = FUN_00285688 + 0x14);
PROVIDE(DAT_002856D8 = FUN_0028569E + 0x3A);
PROVIDE(DAT_0028589C = FUN_002856E4 + 0x1B8);
PROVIDE(DAT_0028592C = FUN_002858A2 + 0x8A);
PROVIDE(DAT_00285A80 = FUN_00285932 + 0x14E);
PROVIDE(DAT_00285B20 = FUN_00285A86 + 0x9A);
PROVIDE(DAT_00285C54 = FUN_00285B28 + 0x12C);
PROVIDE(DAT_00285DB8 = FUN_00285C5E + 0x15A);
PROVIDE(DAT_00285FB4 = FUN_00285DC0 + 0x1F4);
PROVIDE(DAT_002860F8 = FUN_00285FBE + 0x13A);
PROVIDE(DAT_00286224 = FUN_00286208 + 0x1C);
PROVIDE(DAT_00286268 = FUN_0028622A + 0x3E);
PROVIDE(DAT_0028631C = FUN_0028630C + 0x10);
PROVIDE(DAT_0028638C = FUN_0028637C + 0x10);
PROVIDE(DAT_002863E8 = FUN_00286390 + 0x58);
PROVIDE(DAT_00286428 = FUN_002863EC + 0x3C);
PROVIDE(DAT_002865FC = FUN_002865C8 + 0x34);
PROVIDE(DAT_0028665C = FUN_00286602 + 0x5A);
PROVIDE(DAT_002866EC = FUN_002866B8 + 0x34);
PROVIDE(DAT_00286728 = FUN_002866EE + 0x3A);
PROVIDE(DAT_00286790 = FUN_00286778 + 0x18);
PROVIDE(DAT_002867E0 = FUN_00286794 + 0x4C);
PROVIDE(DAT_002868CC = FUN_00286866 + 0x66);
PROVIDE(DAT_0028691C = FUN_002868D0 + 0x4C);
PROVIDE(DAT_00286958 = FUN_0028691E + 0x3A);
PROVIDE(DAT_00286A04 = FUN_002869DC + 0x28);
PROVIDE(DAT_00286A70 = FUN_00286A08 + 0x68);
PROVIDE(DAT_00286DA8 = FUN_00286D38 + 0x70);
PROVIDE(DAT_00286E58 = FUN_00286E24 + 0x34);
PROVIDE(DAT_00286F64 = FUN_00286F30 + 0x34);
PROVIDE(DAT_00287094 = FUN_00287064 + 0x30);
PROVIDE(DAT_002870F0 = FUN_0028709A + 0x56);
PROVIDE(DAT_00287170 = FUN_00287134 + 0x3C);
PROVIDE(DAT_002871B4 = FUN_00287174 + 0x40);
PROVIDE(DAT_002871F0 = FUN_002871B8 + 0x38);
PROVIDE(DAT_002873E4 = FUN_002873C4 + 0x20);
PROVIDE(DAT_00287584 = FUN_00287500 + 0x84);
PROVIDE(DAT_002876BC = FUN_0028767C + 0x40);
PROVIDE(DAT_00287730 = FUN_002876C4 + 0x6C);
PROVIDE(DAT_002877A4 = FUN_00287738 + 0x6C);
PROVIDE(DAT_00287AB0 = FUN_00287A78 + 0x38);
PROVIDE(DAT_00287EF0 = FUN_00287EDC + 0x14);
PROVIDE(DAT_00287EF6 = FUN_00287EDC + 0x1A);
PROVIDE(DAT_00287EFC = FUN_00287EDC + 0x20);
PROVIDE(DAT_00287F02 = FUN_00287EDC + 0x26);
PROVIDE(DAT_00287F08 = FUN_00287EDC + 0x2C);
PROVIDE(DAT_00287F0E = FUN_00287EDC + 0x32);
PROVIDE(DAT_00287F14 = FUN_00287EDC + 0x38);
PROVIDE(DAT_00287F1A = FUN_00287EDC + 0x3E);
PROVIDE(DAT_00287F20 = FUN_00287EDC + 0x44);
PROVIDE(DAT_00287F26 = FUN_00287EDC + 0x4A);
PROVIDE(DAT_00287F2C = FUN_00287EDC + 0x50);
PROVIDE(DAT_00287F32 = FUN_00287EDC + 0x56);
PROVIDE(DAT_00287F38 = FUN_00287EDC + 0x5C);
PROVIDE(DAT_00287F3E = FUN_00287EDC + 0x62);
PROVIDE(DAT_00287F44 = FUN_00287EDC + 0x68);
PROVIDE(DAT_00287F4A = FUN_00287EDC + 0x6E);
PROVIDE(DAT_00287F50 = FUN_00287EDC + 0x74);
PROVIDE(DAT_00287F56 = FUN_00287EDC + 0x7A);
PROVIDE(DAT_00287F5C = FUN_00287EDC + 0x80);
PROVIDE(DAT_00287F62 = FUN_00287EDC + 0x86);
PROVIDE(DAT_00287F68 = FUN_00287EDC + 0x8C);
PROVIDE(DAT_00287F6E = FUN_00287EDC + 0x92);
PROVIDE(DAT_00287F74 = FUN_00287EDC + 0x98);
PROVIDE(DAT_00287F7A = FUN_00287EDC + 0x9E);
PROVIDE(DAT_00287F80 = FUN_00287EDC + 0xA4);
PROVIDE(DAT_00287F86 = FUN_00287EDC + 0xAA);
PROVIDE(DAT_00287F8C = FUN_00287EDC + 0xB0);
PROVIDE(DAT_00287F92 = FUN_00287EDC + 0xB6);
PROVIDE(DAT_00287F98 = FUN_00287EDC + 0xBC);
PROVIDE(DAT_00287F9E = FUN_00287EDC + 0xC2);
PROVIDE(DAT_00287FA4 = FUN_00287EDC + 0xC8);
PROVIDE(DAT_00287FAA = FUN_00287EDC + 0xCE);
PROVIDE(DAT_00287FB0 = FUN_00287EDC + 0xD4);
PROVIDE(DAT_00287FB6 = FUN_00287EDC + 0xDA);
PROVIDE(DAT_00287FBC = FUN_00287EDC + 0xE0);
PROVIDE(DAT_00287FC2 = FUN_00287EDC + 0xE6);
PROVIDE(DAT_00287FC8 = FUN_00287EDC + 0xEC);
PROVIDE(DAT_00287FCE = FUN_00287EDC + 0xF2);
PROVIDE(DAT_00287FD4 = FUN_00287EDC + 0xF8);
PROVIDE(DAT_00287FDA = FUN_00287EDC + 0xFE);
PROVIDE(DAT_00287FE0 = FUN_00287EDC + 0x104);
PROVIDE(DAT_00287FE6 = FUN_00287EDC + 0x10A);
PROVIDE(DAT_00287FEC = FUN_00287EDC + 0x110);
PROVIDE(DAT_00287FF2 = FUN_00287EDC + 0x116);
PROVIDE(DAT_00287FF8 = FUN_00287EDC + 0x11C);
PROVIDE(DAT_00287FFE = FUN_00287EDC + 0x122);
PROVIDE(DAT_00288004 = FUN_00287EDC + 0x128);
PROVIDE(DAT_0028800A = FUN_00287EDC + 0x12E);
PROVIDE(DAT_00288010 = FUN_00287EDC + 0x134);
PROVIDE(DAT_00288016 = FUN_00287EDC + 0x13A);
PROVIDE(DAT_0028801C = FUN_00287EDC + 0x140);
PROVIDE(DAT_00288022 = FUN_00287EDC + 0x146);
PROVIDE(DAT_00288028 = FUN_00287EDC + 0x14C);
PROVIDE(DAT_0028802E = FUN_00287EDC + 0x152);
PROVIDE(DAT_00288034 = FUN_00287EDC + 0x158);
PROVIDE(DAT_0028803A = FUN_00287EDC + 0x15E);
PROVIDE(DAT_00288040 = FUN_00287EDC + 0x164);
PROVIDE(DAT_00288046 = FUN_00287EDC + 0x16A);
PROVIDE(DAT_0028804C = FUN_00287EDC + 0x170);
PROVIDE(DAT_00288052 = FUN_00287EDC + 0x176);
PROVIDE(DAT_00288058 = FUN_00287EDC + 0x17C);
PROVIDE(DAT_0028805E = FUN_00287EDC + 0x182);
PROVIDE(DAT_00288064 = FUN_00287EDC + 0x188);
PROVIDE(DAT_0028806A = FUN_00287EDC + 0x18E);
PROVIDE(DAT_00288070 = FUN_00287EDC + 0x194);
PROVIDE(DAT_00288076 = FUN_00287EDC + 0x19A);
PROVIDE(DAT_0028807C = FUN_00287EDC + 0x1A0);
PROVIDE(DAT_00288082 = FUN_00287EDC + 0x1A6);
PROVIDE(DAT_00288088 = FUN_00287EDC + 0x1AC);
PROVIDE(DAT_0028808E = FUN_00287EDC + 0x1B2);
PROVIDE(DAT_00288094 = FUN_00287EDC + 0x1B8);
PROVIDE(DAT_0028809A = FUN_00287EDC + 0x1BE);
PROVIDE(DAT_002880A0 = FUN_00287EDC + 0x1C4);
PROVIDE(DAT_002880A6 = FUN_00287EDC + 0x1CA);
PROVIDE(DAT_002880AC = FUN_00287EDC + 0x1D0);
PROVIDE(DAT_002880B2 = FUN_00287EDC + 0x1D6);
PROVIDE(DAT_002880B8 = FUN_00287EDC + 0x1DC);
PROVIDE(DAT_002880BE = FUN_00287EDC + 0x1E2);
PROVIDE(DAT_002880C4 = FUN_00287EDC + 0x1E8);
PROVIDE(DAT_002880CA = FUN_00287EDC + 0x1EE);
PROVIDE(DAT_002880D0 = FUN_00287EDC + 0x1F4);
PROVIDE(DAT_002880D6 = FUN_00287EDC + 0x1FA);
PROVIDE(DAT_002880DC = FUN_00287EDC + 0x200);
PROVIDE(DAT_002880E2 = FUN_00287EDC + 0x206);
PROVIDE(DAT_002880E8 = FUN_00287EDC + 0x20C);
PROVIDE(DAT_002880EE = FUN_00287EDC + 0x212);
PROVIDE(DAT_002880F4 = FUN_00287EDC + 0x218);
PROVIDE(DAT_002880FA = FUN_00287EDC + 0x21E);
PROVIDE(DAT_00288100 = FUN_00287EDC + 0x224);
PROVIDE(DAT_00288106 = FUN_00287EDC + 0x22A);
PROVIDE(DAT_0028810C = FUN_00287EDC + 0x230);
PROVIDE(DAT_00288112 = FUN_00287EDC + 0x236);
PROVIDE(DAT_00288118 = FUN_00287EDC + 0x23C);
PROVIDE(DAT_0028811E = FUN_00287EDC + 0x242);
PROVIDE(DAT_00288124 = FUN_00287EDC + 0x248);
PROVIDE(DAT_0028812A = FUN_00287EDC + 0x24E);
PROVIDE(DAT_00288130 = FUN_00287EDC + 0x254);
PROVIDE(DAT_00288136 = FUN_00287EDC + 0x25A);
PROVIDE(DAT_0028813C = FUN_00287EDC + 0x260);
PROVIDE(DAT_00288142 = FUN_00287EDC + 0x266);
PROVIDE(DAT_00288148 = FUN_00287EDC + 0x26C);
PROVIDE(DAT_0028814E = FUN_00287EDC + 0x272);
PROVIDE(DAT_00288154 = FUN_00287EDC + 0x278);
PROVIDE(DAT_0028815A = FUN_00287EDC + 0x27E);
PROVIDE(DAT_00288160 = FUN_00287EDC + 0x284);
PROVIDE(DAT_00288166 = FUN_00287EDC + 0x28A);
PROVIDE(DAT_0028816C = FUN_00287EDC + 0x290);
PROVIDE(DAT_00288172 = FUN_00287EDC + 0x296);
PROVIDE(DAT_00288178 = FUN_00287EDC + 0x29C);
PROVIDE(DAT_0028817E = FUN_00287EDC + 0x2A2);
PROVIDE(DAT_00288184 = FUN_00287EDC + 0x2A8);
PROVIDE(DAT_0028818A = FUN_00287EDC + 0x2AE);
PROVIDE(DAT_00288190 = FUN_00287EDC + 0x2B4);
PROVIDE(DAT_00288196 = FUN_00287EDC + 0x2BA);
PROVIDE(DAT_0028819C = FUN_00287EDC + 0x2C0);
PROVIDE(DAT_002881A2 = FUN_00287EDC + 0x2C6);
PROVIDE(DAT_002881A8 = FUN_00287EDC + 0x2CC);
PROVIDE(DAT_002881AE = FUN_00287EDC + 0x2D2);
PROVIDE(DAT_002881B4 = FUN_00287EDC + 0x2D8);
PROVIDE(DAT_002881BA = FUN_00287EDC + 0x2DE);
PROVIDE(DAT_002881C0 = FUN_00287EDC + 0x2E4);
PROVIDE(DAT_002881C6 = FUN_00287EDC + 0x2EA);
PROVIDE(DAT_002881CC = FUN_00287EDC + 0x2F0);
PROVIDE(DAT_002881D2 = FUN_00287EDC + 0x2F6);
PROVIDE(DAT_002881D8 = FUN_00287EDC + 0x2FC);
PROVIDE(DAT_002881DE = FUN_00287EDC + 0x302);
PROVIDE(DAT_002881E4 = FUN_00287EDC + 0x308);
PROVIDE(DAT_002881EA = FUN_00287EDC + 0x30E);
PROVIDE(DAT_002881F0 = FUN_00287EDC + 0x314);
PROVIDE(DAT_002881F6 = FUN_00287EDC + 0x31A);
PROVIDE(DAT_002881FC = FUN_00287EDC + 0x320);
PROVIDE(DAT_00288202 = FUN_00287EDC + 0x326);
PROVIDE(DAT_00288208 = FUN_00287EDC + 0x32C);
PROVIDE(DAT_0028820E = FUN_00287EDC + 0x332);
PROVIDE(DAT_00288214 = FUN_00287EDC + 0x338);
PROVIDE(DAT_0028821A = FUN_00287EDC + 0x33E);
PROVIDE(DAT_00288220 = FUN_00287EDC + 0x344);
PROVIDE(DAT_00288226 = FUN_00287EDC + 0x34A);
PROVIDE(DAT_0028822C = FUN_00287EDC + 0x350);
PROVIDE(DAT_00288232 = FUN_00287EDC + 0x356);
PROVIDE(DAT_00288238 = FUN_00287EDC + 0x35C);
PROVIDE(DAT_0028823E = FUN_00287EDC + 0x362);
PROVIDE(DAT_00288244 = FUN_00287EDC + 0x368);
PROVIDE(DAT_0028824A = FUN_00287EDC + 0x36E);
PROVIDE(DAT_00288250 = FUN_00287EDC + 0x374);
PROVIDE(DAT_00288256 = FUN_00287EDC + 0x37A);
PROVIDE(DAT_0028825C = FUN_00287EDC + 0x380);
PROVIDE(DAT_00288262 = FUN_00287EDC + 0x386);
PROVIDE(DAT_00288268 = FUN_00287EDC + 0x38C);
PROVIDE(DAT_0028826E = FUN_00287EDC + 0x392);
PROVIDE(DAT_00288274 = FUN_00287EDC + 0x398);
PROVIDE(DAT_0028827A = FUN_00287EDC + 0x39E);
PROVIDE(DAT_00288280 = FUN_00287EDC + 0x3A4);
PROVIDE(DAT_00288286 = FUN_00287EDC + 0x3AA);
PROVIDE(DAT_0028828C = FUN_00287EDC + 0x3B0);
PROVIDE(DAT_00288292 = FUN_00287EDC + 0x3B6);
PROVIDE(DAT_00288298 = FUN_00287EDC + 0x3BC);
PROVIDE(DAT_0028829E = FUN_00287EDC + 0x3C2);
PROVIDE(DAT_002882A4 = FUN_00287EDC + 0x3C8);
PROVIDE(DAT_002882AA = FUN_00287EDC + 0x3CE);
PROVIDE(DAT_002882B0 = FUN_00287EDC + 0x3D4);
PROVIDE(DAT_002882B6 = FUN_00287EDC + 0x3DA);
PROVIDE(DAT_002882BC = FUN_00287EDC + 0x3E0);
PROVIDE(DAT_002882C2 = FUN_00287EDC + 0x3E6);
PROVIDE(DAT_002882C8 = FUN_00287EDC + 0x3EC);
PROVIDE(DAT_002882CE = FUN_00287EDC + 0x3F2);
PROVIDE(DAT_002882D4 = FUN_00287EDC + 0x3F8);
PROVIDE(DAT_002882DA = FUN_00287EDC + 0x3FE);
PROVIDE(DAT_002882E0 = FUN_00287EDC + 0x404);
PROVIDE(DAT_002882E6 = FUN_00287EDC + 0x40A);
PROVIDE(DAT_002882EC = FUN_00287EDC + 0x410);
PROVIDE(DAT_002882F2 = FUN_00287EDC + 0x416);
PROVIDE(DAT_002882F8 = FUN_00287EDC + 0x41C);
PROVIDE(DAT_002882FE = FUN_00287EDC + 0x422);
PROVIDE(DAT_00288304 = FUN_00287EDC + 0x428);
PROVIDE(DAT_0028830A = FUN_00287EDC + 0x42E);
PROVIDE(DAT_00288310 = FUN_00287EDC + 0x434);
PROVIDE(DAT_00288316 = FUN_00287EDC + 0x43A);
PROVIDE(DAT_0028831C = FUN_00287EDC + 0x440);
PROVIDE(DAT_00288322 = FUN_00287EDC + 0x446);
PROVIDE(DAT_00288328 = FUN_00287EDC + 0x44C);
PROVIDE(DAT_0028832E = FUN_00287EDC + 0x452);
PROVIDE(DAT_00288334 = FUN_00287EDC + 0x458);
PROVIDE(DAT_0028833A = FUN_00287EDC + 0x45E);
PROVIDE(DAT_00288340 = FUN_00287EDC + 0x464);
PROVIDE(DAT_00288346 = FUN_00287EDC + 0x46A);
PROVIDE(DAT_0028834C = FUN_00287EDC + 0x470);
PROVIDE(DAT_00288352 = FUN_00287EDC + 0x476);
PROVIDE(DAT_00288358 = FUN_00287EDC + 0x47C);
PROVIDE(DAT_0028835E = FUN_00287EDC + 0x482);
PROVIDE(DAT_00288364 = FUN_00287EDC + 0x488);
PROVIDE(DAT_0028836A = FUN_00287EDC + 0x48E);
PROVIDE(DAT_00288370 = FUN_00287EDC + 0x494);
PROVIDE(DAT_00288376 = FUN_00287EDC + 0x49A);
PROVIDE(DAT_0028837C = FUN_00287EDC + 0x4A0);
PROVIDE(DAT_00288382 = FUN_00287EDC + 0x4A6);
PROVIDE(DAT_00288388 = FUN_00287EDC + 0x4AC);
PROVIDE(DAT_0028838E = FUN_00287EDC + 0x4B2);
PROVIDE(DAT_00288394 = FUN_00287EDC + 0x4B8);
PROVIDE(DAT_0028839A = FUN_00287EDC + 0x4BE);
PROVIDE(DAT_002883A0 = FUN_00287EDC + 0x4C4);
PROVIDE(DAT_002883A6 = FUN_00287EDC + 0x4CA);
PROVIDE(DAT_002883AC = FUN_00287EDC + 0x4D0);
PROVIDE(DAT_002883B2 = FUN_00287EDC + 0x4D6);
PROVIDE(DAT_002883B8 = FUN_00287EDC + 0x4DC);
PROVIDE(DAT_002883BE = FUN_00287EDC + 0x4E2);
PROVIDE(DAT_002883C4 = FUN_00287EDC + 0x4E8);
PROVIDE(DAT_002883CA = FUN_00287EDC + 0x4EE);
PROVIDE(DAT_002883D0 = FUN_00287EDC + 0x4F4);
PROVIDE(DAT_002883D6 = FUN_00287EDC + 0x4FA);
PROVIDE(DAT_002883DC = FUN_00287EDC + 0x500);
PROVIDE(DAT_002883E2 = FUN_00287EDC + 0x506);
PROVIDE(DAT_002883E8 = FUN_00287EDC + 0x50C);
PROVIDE(DAT_002883EE = FUN_00287EDC + 0x512);
PROVIDE(DAT_002883F4 = FUN_00287EDC + 0x518);
PROVIDE(DAT_002883FA = FUN_00287EDC + 0x51E);
PROVIDE(DAT_00288400 = FUN_00287EDC + 0x524);
PROVIDE(DAT_00288406 = FUN_00287EDC + 0x52A);
PROVIDE(DAT_0028840C = FUN_00287EDC + 0x530);
PROVIDE(DAT_00288412 = FUN_00287EDC + 0x536);
PROVIDE(DAT_00288418 = FUN_00287EDC + 0x53C);
PROVIDE(DAT_0028841E = FUN_00287EDC + 0x542);
PROVIDE(DAT_00288424 = FUN_00287EDC + 0x548);
PROVIDE(DAT_0028842A = FUN_00287EDC + 0x54E);
PROVIDE(DAT_00288430 = FUN_00287EDC + 0x554);
PROVIDE(DAT_00288436 = FUN_00287EDC + 0x55A);
PROVIDE(DAT_0028843C = FUN_00287EDC + 0x560);
PROVIDE(DAT_00288442 = FUN_00287EDC + 0x566);
PROVIDE(DAT_00288448 = FUN_00287EDC + 0x56C);
PROVIDE(DAT_0028844E = FUN_00287EDC + 0x572);
PROVIDE(DAT_00288454 = FUN_00287EDC + 0x578);
PROVIDE(DAT_0028845A = FUN_00287EDC + 0x57E);
PROVIDE(DAT_00288460 = FUN_00287EDC + 0x584);
PROVIDE(DAT_00288466 = FUN_00287EDC + 0x58A);
PROVIDE(DAT_0028846C = FUN_00287EDC + 0x590);
PROVIDE(DAT_00288472 = FUN_00287EDC + 0x596);
PROVIDE(DAT_00288478 = FUN_00287EDC + 0x59C);
PROVIDE(DAT_0028847E = FUN_00287EDC + 0x5A2);
PROVIDE(DAT_00288484 = FUN_00287EDC + 0x5A8);
PROVIDE(DAT_0028848A = FUN_00287EDC + 0x5AE);
PROVIDE(DAT_00288490 = FUN_00287EDC + 0x5B4);
PROVIDE(DAT_00288496 = FUN_00287EDC + 0x5BA);
PROVIDE(DAT_0028849C = FUN_00287EDC + 0x5C0);
PROVIDE(DAT_002884A2 = FUN_00287EDC + 0x5C6);
PROVIDE(DAT_002884A8 = FUN_00287EDC + 0x5CC);
PROVIDE(DAT_002884AE = FUN_00287EDC + 0x5D2);
PROVIDE(DAT_002884B4 = FUN_00287EDC + 0x5D8);
PROVIDE(DAT_002884BA = FUN_00287EDC + 0x5DE);
PROVIDE(DAT_002884C0 = FUN_00287EDC + 0x5E4);
PROVIDE(DAT_002884C6 = FUN_00287EDC + 0x5EA);
PROVIDE(DAT_002884CC = FUN_00287EDC + 0x5F0);
PROVIDE(DAT_002884D2 = FUN_00287EDC + 0x5F6);
PROVIDE(DAT_002884D8 = FUN_00287EDC + 0x5FC);
PROVIDE(DAT_002884DE = FUN_00287EDC + 0x602);
PROVIDE(DAT_002884E4 = FUN_00287EDC + 0x608);
PROVIDE(DAT_002884EA = FUN_00287EDC + 0x60E);
PROVIDE(DAT_00288514 = FUN_002884FC + 0x18);
PROVIDE(DAT_002885A0 = FUN_002884FC + 0xA4);
PROVIDE(DAT_00288676 = FUN_002884FC + 0x17A);
PROVIDE(DAT_002887C0 = FUN_00288764 + 0x5C);
PROVIDE(DAT_00289768 = FUN_00288764 + 0x1004);
PROVIDE(DAT_00289774 = FUN_00288764 + 0x1010);
PROVIDE(DAT_00289EF4 = FUN_00288764 + 0x1790);
PROVIDE(DAT_00289F00 = FUN_00288764 + 0x179C);
PROVIDE(DAT_0028A680 = FUN_00288764 + 0x1F1C);
PROVIDE(DAT_0028A68C = FUN_00288764 + 0x1F28);
PROVIDE(DAT_0028AE0C = FUN_00288764 + 0x26A8);
PROVIDE(DAT_0028AE10 = FUN_00288764 + 0x26AC);
PROVIDE(DAT_0028AE12 = FUN_00288764 + 0x26AE);
PROVIDE(DAT_0028AE30 = FUN_00288764 + 0x26CC);

/* sym_ symbols: external/RAM addresses, absolute (81) */
PROVIDE(sym_00200000 = 0x00200000);
PROVIDE(sym_0023FFFF = 0x0023FFFF);
PROVIDE(sym_0028B030 = 0x0028B030);
PROVIDE(sym_0028B034 = 0x0028B034);
PROVIDE(sym_0028B03C = 0x0028B03C);
PROVIDE(sym_0028B040 = 0x0028B040);
PROVIDE(sym_0028B04C = 0x0028B04C);
PROVIDE(sym_0028B050 = 0x0028B050);
PROVIDE(sym_0028B054 = 0x0028B054);
PROVIDE(sym_0028B05C = 0x0028B05C);
PROVIDE(sym_0028B060 = 0x0028B060);
PROVIDE(sym_0028B064 = 0x0028B064);
PROVIDE(sym_0028B068 = 0x0028B068);
PROVIDE(sym_0028B069 = 0x0028B069);
PROVIDE(sym_0028B06A = 0x0028B06A);
PROVIDE(sym_0028B070 = 0x0028B070);
PROVIDE(sym_0028B074 = 0x0028B074);
PROVIDE(sym_0028B078 = 0x0028B078);
PROVIDE(sym_0028B07C = 0x0028B07C);
PROVIDE(sym_0028B080 = 0x0028B080);
PROVIDE(sym_0028B084 = 0x0028B084);
PROVIDE(sym_0028B088 = 0x0028B088);
PROVIDE(sym_0028B090 = 0x0028B090);
PROVIDE(sym_0028B490 = 0x0028B490);
PROVIDE(sym_002F0000 = 0x002F0000);
PROVIDE(sym_002F00C8 = 0x002F00C8);
PROVIDE(sym_002F00E8 = 0x002F00E8);
PROVIDE(sym_002F0120 = 0x002F0120);
PROVIDE(sym_002F0124 = 0x002F0124);
PROVIDE(sym_002F0134 = 0x002F0134);
PROVIDE(sym_002F0144 = 0x002F0144);
PROVIDE(sym_002F0154 = 0x002F0154);
PROVIDE(sym_038FFFFF = 0x038FFFFF);
PROVIDE(sym_0600026C = 0x0600026C);
PROVIDE(sym_060002A0 = 0x060002A0);
PROVIDE(sym_06000300 = 0x06000300);
PROVIDE(sym_06000304 = 0x06000304);
PROVIDE(sym_06000310 = 0x06000310);
PROVIDE(sym_06000314 = 0x06000314);
PROVIDE(sym_06000340 = 0x06000340);
PROVIDE(sym_06000344 = 0x06000344);
PROVIDE(sym_06000348 = 0x06000348);
PROVIDE(sym_06000C00 = 0x06000C00);
PROVIDE(sym_06000CCC = 0x06000CCC);
PROVIDE(sym_06000CCD = 0x06000CCD);
PROVIDE(sym_06000CCE = 0x06000CCE);
PROVIDE(sym_06002000 = 0x06002000);
PROVIDE(sym_060020E0 = 0x060020E0);
PROVIDE(sym_06002100 = 0x06002100);
PROVIDE(sym_06002270 = 0x06002270);
PROVIDE(sym_06002F00 = 0x06002F00);
PROVIDE(sym_06002F28 = 0x06002F28);
PROVIDE(sym_06006000 = 0x06006000);
PROVIDE(sym_06006002 = 0x06006002);
PROVIDE(sym_06100000 = 0x06100000);
PROVIDE(sym_20100001 = 0x20100001);
PROVIDE(sym_2010001F = 0x2010001F);
PROVIDE(sym_20100021 = 0x20100021);
PROVIDE(sym_20100061 = 0x20100061);
PROVIDE(sym_20100063 = 0x20100063);
PROVIDE(sym_23FFFFFF = 0x23FFFFFF);
PROVIDE(sym_24000380 = 0x24000380);
PROVIDE(sym_2400045C = 0x2400045C);
PROVIDE(sym_257FFFFC = 0x257FFFFC);
PROVIDE(sym_25810028 = 0x25810028);
PROVIDE(sym_25818000 = 0x25818000);
PROVIDE(sym_25885029 = 0x25885029);
PROVIDE(sym_25890008 = 0x25890008);
PROVIDE(sym_2589000C = 0x2589000C);
PROVIDE(sym_25890018 = 0x25890018);
PROVIDE(sym_2589001C = 0x2589001C);
PROVIDE(sym_25890020 = 0x25890020);
PROVIDE(sym_25890024 = 0x25890024);
PROVIDE(sym_25898000 = 0x25898000);
PROVIDE(sym_25FE0000 = 0x25FE0000);
PROVIDE(sym_25FE0004 = 0x25FE0004);
PROVIDE(sym_25FE0008 = 0x25FE0008);
PROVIDE(sym_25FE000C = 0x25FE000C);
PROVIDE(sym_25FE0010 = 0x25FE0010);
PROVIDE(sym_25FE0014 = 0x25FE0014);
PROVIDE(sym_25FE00B0 = 0x25FE00B0);
