/* ================================================================
 * init_free.ld  --  Free-layout linker script for init
 *
 * Functions can change size without breaking the binary.
 * __pad_size shifts all FUN_ addresses to validate relocation.
 *
 * Runtime offset: 0x5200  (linker base 0x06000000, runtime base 0x06005200)
 * IP.BIN/main loads this module at 0x06005200, not 0x06000000.
 * Shadow-zone DAT_ offsets include this difference.
 *
 * Usage:
 *   make validate-free          # zero-shift, byte-identical
 *   make disc-4shift            # +4 shift boot test
 *
 * Generated by gen_free_ld.py from init_symbols.json
 * ================================================================ */

OUTPUT_FORMAT("elf32-sh")
OUTPUT_ARCH(sh)
ENTRY(FUN_06000000)

/* Default: no padding. Override with --defsym __pad_size=N */
PROVIDE(__pad_size = 0);

/* Runtime load offset: module loads at 0x06005200, not linker base 0x06000000.
   Shadow-zone DAT_ symbols (0x06014820-0x06019A20) use offsets that
   include this 0x5200 difference so they resolve to correct runtime addresses. */
__runtime_offset = 0x5200;

SECTIONS
{
    . = 0x06000000;

    /* Pin entry function at module base so boot code can find it. */
    /* It stays at the original address; its pool refs resolve to */
    /* shifted targets, so the jump lands in the right place.      */
    .entry : { *(.text.FUN_06000000) }

    .text : {
        . = . + __pad_size;
        *(SORT_BY_NAME(.text.FUN_*))
    }

    /DISCARD/ : {
        *(.comment)
        *(.note*)
        *(.eh_frame)
    }
}

/* DAT_ symbols: 642 normal + 27 shadow-zone = 669 total */
PROVIDE(DAT_06005568 = FUN_06005532 + 0x36);
PROVIDE(DAT_06005652 = FUN_06005628 + 0x2A);
PROVIDE(DAT_0600574C = FUN_060056F8 + 0x54);
PROVIDE(DAT_060068B8 = FUN_0600689E + 0x1A);
PROVIDE(DAT_060071B6 = FUN_060071AE + 0x8);
PROVIDE(DAT_060072C4 = FUN_06007274 + 0x50);
PROVIDE(DAT_06007300 = FUN_060072E4 + 0x1C);
PROVIDE(DAT_0600737C = FUN_0600736E + 0xE);
PROVIDE(DAT_0600738A = FUN_0600736E + 0x1C);
PROVIDE(DAT_06007398 = FUN_0600736E + 0x2A);
PROVIDE(DAT_06007430 = FUN_0600742E + 0x2);
PROVIDE(DAT_06007498 = FUN_0600742E + 0x6A);
PROVIDE(DAT_0600765C = FUN_0600753C + 0x120);
PROVIDE(DAT_06007B2E = FUN_06007A8A + 0xA4);
PROVIDE(DAT_06007C50 = FUN_06007C3A + 0x16);
PROVIDE(DAT_06007E0E = FUN_06007D9E + 0x70);
PROVIDE(DAT_06008098 = FUN_0600802E + 0x6A);
PROVIDE(DAT_06008146 = FUN_0600812C + 0x1A);
PROVIDE(DAT_0600841E = FUN_060083FE + 0x20);
PROVIDE(DAT_0600845C = FUN_060083FE + 0x5E);
PROVIDE(DAT_060089A6 = FUN_0600899A + 0xC);
PROVIDE(DAT_06008C88 = FUN_06008C4A + 0x3E);
PROVIDE(DAT_06008D0E = FUN_06008C90 + 0x7E);
PROVIDE(DAT_06008D88 = FUN_06008C90 + 0xF8);
PROVIDE(DAT_06008DB4 = FUN_06008DB0 + 0x4);
PROVIDE(DAT_06008DD2 = FUN_06008DB0 + 0x22);
PROVIDE(DAT_06008E9A = FUN_06008E88 + 0x12);
PROVIDE(DAT_06008E9E = FUN_06008E88 + 0x16);
PROVIDE(DAT_06008EA2 = FUN_06008E88 + 0x1A);
PROVIDE(DAT_06008EA6 = FUN_06008E88 + 0x1E);
PROVIDE(DAT_06008EAA = FUN_06008E88 + 0x22);
PROVIDE(DAT_06008EAE = FUN_06008EAC + 0x2);
PROVIDE(DAT_06008EB2 = FUN_06008EAC + 0x6);
PROVIDE(DAT_06008EB6 = FUN_06008EAC + 0xA);
PROVIDE(DAT_06008EBA = FUN_06008EAC + 0xE);
PROVIDE(DAT_06008EBE = FUN_06008EAC + 0x12);
PROVIDE(DAT_06008EC2 = FUN_06008EAC + 0x16);
PROVIDE(DAT_06008EC6 = FUN_06008EAC + 0x1A);
PROVIDE(DAT_06008ECA = FUN_06008EAC + 0x1E);
PROVIDE(DAT_06008ECE = FUN_06008EAC + 0x22);
PROVIDE(DAT_06008ED2 = FUN_06008EAC + 0x26);
PROVIDE(DAT_06008ED6 = FUN_06008EAC + 0x2A);
PROVIDE(DAT_06008ED8 = FUN_06008EAC + 0x2C);
PROVIDE(DAT_06008EDC = FUN_06008EAC + 0x30);
PROVIDE(DAT_06008F54 = FUN_06008F36 + 0x1E);
PROVIDE(DAT_06008F98 = FUN_06008F8E + 0xA);
PROVIDE(DAT_06008F9E = FUN_06008F8E + 0x10);
PROVIDE(DAT_06008FA4 = FUN_06008F8E + 0x16);
PROVIDE(DAT_06008FAA = FUN_06008F8E + 0x1C);
PROVIDE(DAT_06008FB0 = FUN_06008F8E + 0x22);
PROVIDE(DAT_06008FB6 = FUN_06008F8E + 0x28);
PROVIDE(DAT_06008FBC = FUN_06008F8E + 0x2E);
PROVIDE(DAT_06008FC2 = FUN_06008F8E + 0x34);
PROVIDE(DAT_06008FC8 = FUN_06008F8E + 0x3A);
PROVIDE(DAT_06008FCE = FUN_06008F8E + 0x40);
PROVIDE(DAT_06008FD4 = FUN_06008F8E + 0x46);
PROVIDE(DAT_06008FDA = FUN_06008F8E + 0x4C);
PROVIDE(DAT_06008FE0 = FUN_06008F8E + 0x52);
PROVIDE(DAT_06008FE6 = FUN_06008F8E + 0x58);
PROVIDE(DAT_06008FEC = FUN_06008F8E + 0x5E);
PROVIDE(DAT_06008FF2 = FUN_06008F8E + 0x64);
PROVIDE(DAT_06008FF8 = FUN_06008F8E + 0x6A);
PROVIDE(DAT_06008FFE = FUN_06008F8E + 0x70);
PROVIDE(DAT_06009004 = FUN_06008F8E + 0x76);
PROVIDE(DAT_0600900A = FUN_06008F8E + 0x7C);
PROVIDE(DAT_06009010 = FUN_06008F8E + 0x82);
PROVIDE(DAT_06009016 = FUN_06008F8E + 0x88);
PROVIDE(DAT_0600901C = FUN_06008F8E + 0x8E);
PROVIDE(DAT_06009022 = FUN_06008F8E + 0x94);
PROVIDE(DAT_06009028 = FUN_06008F8E + 0x9A);
PROVIDE(DAT_0600902E = FUN_06008F8E + 0xA0);
PROVIDE(DAT_06009034 = FUN_06008F8E + 0xA6);
PROVIDE(DAT_0600903A = FUN_06008F8E + 0xAC);
PROVIDE(DAT_06009040 = FUN_06008F8E + 0xB2);
PROVIDE(DAT_06009046 = FUN_06008F8E + 0xB8);
PROVIDE(DAT_0600904C = FUN_06008F8E + 0xBE);
PROVIDE(DAT_06009052 = FUN_0600904E + 0x4);
PROVIDE(DAT_06009058 = FUN_0600904E + 0xA);
PROVIDE(DAT_0600905E = FUN_0600904E + 0x10);
PROVIDE(DAT_06009064 = FUN_0600904E + 0x16);
PROVIDE(DAT_0600906A = FUN_0600904E + 0x1C);
PROVIDE(DAT_06009070 = FUN_0600904E + 0x22);
PROVIDE(DAT_06009076 = FUN_0600904E + 0x28);
PROVIDE(DAT_0600907C = FUN_0600904E + 0x2E);
PROVIDE(DAT_06009082 = FUN_0600904E + 0x34);
PROVIDE(DAT_06009088 = FUN_0600904E + 0x3A);
PROVIDE(DAT_06009094 = FUN_06009090 + 0x4);
PROVIDE(DAT_0600909A = FUN_06009098 + 0x2);
PROVIDE(DAT_060090A0 = FUN_06009098 + 0x8);
PROVIDE(DAT_060090A6 = FUN_06009098 + 0xE);
PROVIDE(DAT_060090AC = FUN_06009098 + 0x14);
PROVIDE(DAT_060090B2 = FUN_06009098 + 0x1A);
PROVIDE(DAT_060090B8 = FUN_06009098 + 0x20);
PROVIDE(DAT_060090BE = FUN_06009098 + 0x26);
PROVIDE(DAT_060090C4 = FUN_06009098 + 0x2C);
PROVIDE(DAT_060090CA = FUN_06009098 + 0x32);
PROVIDE(DAT_060090D0 = FUN_06009098 + 0x38);
PROVIDE(DAT_060090D6 = FUN_06009098 + 0x3E);
PROVIDE(DAT_060090DC = FUN_06009098 + 0x44);
PROVIDE(DAT_060090E2 = FUN_06009098 + 0x4A);
PROVIDE(DAT_060090E8 = FUN_06009098 + 0x50);
PROVIDE(DAT_060090EE = FUN_06009098 + 0x56);
PROVIDE(DAT_060090F4 = FUN_06009098 + 0x5C);  /* manual: jump table entry */
PROVIDE(DAT_060090FA = FUN_06009098 + 0x62);
PROVIDE(DAT_06009100 = FUN_06009098 + 0x68);
PROVIDE(DAT_06009106 = FUN_06009098 + 0x6E);
PROVIDE(DAT_0600910C = FUN_06009098 + 0x74);
PROVIDE(DAT_06009112 = FUN_06009098 + 0x7A);
PROVIDE(DAT_06009118 = FUN_06009098 + 0x80);
PROVIDE(DAT_0600911E = FUN_06009098 + 0x86);
PROVIDE(DAT_06009124 = FUN_06009098 + 0x8C);
PROVIDE(DAT_0600912A = FUN_06009098 + 0x92);
PROVIDE(DAT_06009130 = FUN_06009098 + 0x98);
PROVIDE(DAT_06009136 = FUN_06009098 + 0x9E);
PROVIDE(DAT_0600913C = FUN_06009098 + 0xA4);
PROVIDE(DAT_06009142 = FUN_06009098 + 0xAA);
PROVIDE(DAT_0600914E = FUN_06009148 + 0x6);
PROVIDE(DAT_06009154 = FUN_06009148 + 0xC);
PROVIDE(DAT_0600915A = FUN_06009148 + 0x12);
PROVIDE(DAT_06009160 = FUN_06009148 + 0x18);
PROVIDE(DAT_06009166 = FUN_06009148 + 0x1E);
PROVIDE(DAT_0600916C = FUN_06009148 + 0x24);
PROVIDE(DAT_06009172 = FUN_06009148 + 0x2A);
PROVIDE(DAT_06009178 = FUN_06009148 + 0x30);
PROVIDE(DAT_0600917E = FUN_06009148 + 0x36);
PROVIDE(DAT_06009184 = FUN_06009148 + 0x3C);
PROVIDE(DAT_0600918A = FUN_06009148 + 0x42);
PROVIDE(DAT_06009190 = FUN_06009148 + 0x48);
PROVIDE(DAT_06009196 = FUN_06009148 + 0x4E);
PROVIDE(DAT_0600919C = FUN_06009148 + 0x54);
PROVIDE(DAT_060091A2 = FUN_06009148 + 0x5A);
PROVIDE(DAT_060091A8 = FUN_06009148 + 0x60);
PROVIDE(DAT_060091AE = FUN_06009148 + 0x66);
PROVIDE(DAT_060091B4 = FUN_06009148 + 0x6C);
PROVIDE(DAT_060091BA = FUN_06009148 + 0x72);
PROVIDE(DAT_060091C0 = FUN_06009148 + 0x78);
PROVIDE(DAT_060091C6 = FUN_06009148 + 0x7E);
PROVIDE(DAT_060091CC = FUN_06009148 + 0x84);
PROVIDE(DAT_060091D2 = FUN_06009148 + 0x8A);
PROVIDE(DAT_060091D8 = FUN_06009148 + 0x90);
PROVIDE(DAT_060091DE = FUN_06009148 + 0x96);
PROVIDE(DAT_060091E4 = FUN_06009148 + 0x9C);
PROVIDE(DAT_060091EA = FUN_06009148 + 0xA2);
PROVIDE(DAT_060091F0 = FUN_06009148 + 0xA8);
PROVIDE(DAT_060091F6 = FUN_06009148 + 0xAE);
PROVIDE(DAT_060091FC = FUN_06009148 + 0xB4);
PROVIDE(DAT_06009202 = FUN_06009148 + 0xBA);
PROVIDE(DAT_06009208 = FUN_06009148 + 0xC0);
PROVIDE(DAT_0600920E = FUN_06009148 + 0xC6);
PROVIDE(DAT_06009214 = FUN_06009148 + 0xCC);
PROVIDE(DAT_0600921A = FUN_06009148 + 0xD2);
PROVIDE(DAT_06009220 = FUN_06009148 + 0xD8);
PROVIDE(DAT_06009226 = FUN_06009148 + 0xDE);
PROVIDE(DAT_0600922C = FUN_06009148 + 0xE4);
PROVIDE(DAT_06009232 = FUN_06009148 + 0xEA);
PROVIDE(DAT_06009238 = FUN_06009148 + 0xF0);
PROVIDE(DAT_0600923E = FUN_06009148 + 0xF6);
PROVIDE(DAT_06009244 = FUN_06009148 + 0xFC);
PROVIDE(DAT_0600924A = FUN_06009148 + 0x102);
PROVIDE(DAT_06009250 = FUN_06009148 + 0x108);
PROVIDE(DAT_06009256 = FUN_06009148 + 0x10E);
PROVIDE(DAT_0600925C = FUN_06009148 + 0x114);
PROVIDE(DAT_06009262 = FUN_06009148 + 0x11A);
PROVIDE(DAT_06009268 = FUN_06009148 + 0x120);
PROVIDE(DAT_0600926E = FUN_06009148 + 0x126);
PROVIDE(DAT_06009274 = FUN_06009148 + 0x12C);
PROVIDE(DAT_0600927A = FUN_06009148 + 0x132);
PROVIDE(DAT_06009280 = FUN_06009148 + 0x138);
PROVIDE(DAT_06009286 = FUN_06009148 + 0x13E);
PROVIDE(DAT_0600928C = FUN_06009288 + 0x4);
PROVIDE(DAT_06009292 = FUN_06009290 + 0x2);
PROVIDE(DAT_06009298 = FUN_06009290 + 0x8);
PROVIDE(DAT_0600929E = FUN_06009290 + 0xE);
PROVIDE(DAT_060092A4 = FUN_06009290 + 0x14);
PROVIDE(DAT_060092AA = FUN_06009290 + 0x1A);
PROVIDE(DAT_060092B0 = FUN_06009290 + 0x20);
PROVIDE(DAT_060092B6 = FUN_06009290 + 0x26);
PROVIDE(DAT_060092BC = FUN_06009290 + 0x2C);
PROVIDE(DAT_060092C2 = FUN_06009290 + 0x32);
PROVIDE(DAT_060092C8 = FUN_06009290 + 0x38);
PROVIDE(DAT_060092CE = FUN_06009290 + 0x3E);
PROVIDE(DAT_060092D4 = FUN_06009290 + 0x44);
PROVIDE(DAT_060092DA = FUN_06009290 + 0x4A);
PROVIDE(DAT_060092E0 = FUN_06009290 + 0x50);
PROVIDE(DAT_060092E6 = FUN_06009290 + 0x56);
PROVIDE(DAT_060092EC = FUN_06009290 + 0x5C);
PROVIDE(DAT_060092F2 = FUN_06009290 + 0x62);
PROVIDE(DAT_060092F8 = FUN_06009290 + 0x68);
PROVIDE(DAT_060092FE = FUN_06009290 + 0x6E);
PROVIDE(DAT_06009304 = FUN_06009290 + 0x74);
PROVIDE(DAT_0600930A = FUN_06009290 + 0x7A);
PROVIDE(DAT_06009310 = FUN_06009290 + 0x80);
PROVIDE(DAT_06009316 = FUN_06009290 + 0x86);
PROVIDE(DAT_0600931C = FUN_06009290 + 0x8C);
PROVIDE(DAT_06009322 = FUN_06009290 + 0x92);
PROVIDE(DAT_06009328 = FUN_06009290 + 0x98);
PROVIDE(DAT_0600932E = FUN_06009290 + 0x9E);
PROVIDE(DAT_06009334 = FUN_06009290 + 0xA4);
PROVIDE(DAT_0600933A = FUN_06009290 + 0xAA);
PROVIDE(DAT_06009340 = FUN_06009290 + 0xB0);
PROVIDE(DAT_06009346 = FUN_06009290 + 0xB6);
PROVIDE(DAT_0600934C = FUN_06009290 + 0xBC);
PROVIDE(DAT_06009352 = FUN_06009290 + 0xC2);
PROVIDE(DAT_06009358 = FUN_06009290 + 0xC8);
PROVIDE(DAT_0600935E = FUN_06009290 + 0xCE);
PROVIDE(DAT_0600936A = FUN_06009364 + 0x6);
PROVIDE(DAT_06009370 = FUN_06009364 + 0xC);
PROVIDE(DAT_06009376 = FUN_06009364 + 0x12);
PROVIDE(DAT_06009382 = FUN_0600937C + 0x6);
PROVIDE(DAT_06009388 = FUN_06009386 + 0x2);
PROVIDE(DAT_0600938E = FUN_06009386 + 0x8);
PROVIDE(DAT_06009394 = FUN_06009386 + 0xE);
PROVIDE(DAT_0600939A = FUN_06009386 + 0x14);
PROVIDE(DAT_060093A0 = FUN_06009386 + 0x1A);
PROVIDE(DAT_060093A6 = FUN_06009386 + 0x20);
PROVIDE(DAT_060093AC = FUN_06009386 + 0x26);
PROVIDE(DAT_060093B2 = FUN_06009386 + 0x2C);
PROVIDE(DAT_060093B8 = FUN_06009386 + 0x32);
PROVIDE(DAT_060093BE = FUN_06009386 + 0x38);
PROVIDE(DAT_060093C4 = FUN_06009386 + 0x3E);
PROVIDE(DAT_060093CA = FUN_06009386 + 0x44);
PROVIDE(DAT_060093D0 = FUN_06009386 + 0x4A);
PROVIDE(DAT_060093D6 = FUN_06009386 + 0x50);
PROVIDE(DAT_060093DC = FUN_06009386 + 0x56);
PROVIDE(DAT_060093E2 = FUN_06009386 + 0x5C);
PROVIDE(DAT_060093E8 = FUN_06009386 + 0x62);
PROVIDE(DAT_060093EE = FUN_06009386 + 0x68);
PROVIDE(DAT_060093F4 = FUN_06009386 + 0x6E);
PROVIDE(DAT_060093FA = FUN_06009386 + 0x74);
PROVIDE(DAT_06009400 = FUN_06009386 + 0x7A);
PROVIDE(DAT_06009406 = FUN_06009386 + 0x80);
PROVIDE(DAT_0600940C = FUN_06009386 + 0x86);
PROVIDE(DAT_06009412 = FUN_06009386 + 0x8C);
PROVIDE(DAT_06009418 = FUN_06009386 + 0x92);
PROVIDE(DAT_0600941E = FUN_06009386 + 0x98);
PROVIDE(DAT_06009424 = FUN_06009386 + 0x9E);
PROVIDE(DAT_0600942A = FUN_06009386 + 0xA4);
PROVIDE(DAT_06009430 = FUN_06009386 + 0xAA);
PROVIDE(DAT_06009436 = FUN_06009386 + 0xB0);
PROVIDE(DAT_0600943C = FUN_06009386 + 0xB6);
PROVIDE(DAT_06009448 = FUN_06009442 + 0x6);
PROVIDE(DAT_0600944E = FUN_06009442 + 0xC);
PROVIDE(DAT_06009454 = FUN_06009442 + 0x12);
PROVIDE(DAT_0600945A = FUN_06009442 + 0x18);
PROVIDE(DAT_06009460 = FUN_06009442 + 0x1E);
PROVIDE(DAT_06009466 = FUN_06009442 + 0x24);
PROVIDE(DAT_0600946C = FUN_06009442 + 0x2A);
PROVIDE(DAT_06009472 = FUN_06009442 + 0x30);
PROVIDE(DAT_06009478 = FUN_06009474 + 0x4);
PROVIDE(DAT_0600947E = FUN_06009474 + 0xA);
PROVIDE(DAT_06009484 = FUN_06009474 + 0x10);
PROVIDE(DAT_0600948A = FUN_06009474 + 0x16);
PROVIDE(DAT_06009490 = FUN_0600948C + 0x4);
PROVIDE(DAT_06009496 = FUN_06009494 + 0x2);
PROVIDE(DAT_0600949C = FUN_06009494 + 0x8);
PROVIDE(DAT_060094A2 = FUN_06009494 + 0xE);
PROVIDE(DAT_060094A8 = FUN_06009494 + 0x14);
PROVIDE(DAT_060094AE = FUN_06009494 + 0x1A);
PROVIDE(DAT_060094B4 = FUN_06009494 + 0x20);
PROVIDE(DAT_060094BA = FUN_06009494 + 0x26);
PROVIDE(DAT_060094C0 = FUN_06009494 + 0x2C);
PROVIDE(DAT_060094C6 = FUN_06009494 + 0x32);
PROVIDE(DAT_060094CC = FUN_06009494 + 0x38);
PROVIDE(DAT_060094D2 = FUN_06009494 + 0x3E);
PROVIDE(DAT_060094D8 = FUN_06009494 + 0x44);
PROVIDE(DAT_060094DE = FUN_06009494 + 0x4A);
PROVIDE(DAT_060094EA = FUN_060094E4 + 0x6);
PROVIDE(DAT_060094F6 = FUN_060094F0 + 0x6);
PROVIDE(DAT_060094FC = FUN_060094F0 + 0xC);
PROVIDE(DAT_06009502 = FUN_060094F0 + 0x12);
PROVIDE(DAT_06009508 = FUN_060094F0 + 0x18);
PROVIDE(DAT_0600950E = FUN_060094F0 + 0x1E);
PROVIDE(DAT_06009514 = FUN_060094F0 + 0x24);
PROVIDE(DAT_0600951A = FUN_060094F0 + 0x2A);
PROVIDE(DAT_06009520 = FUN_060094F0 + 0x30);
PROVIDE(DAT_06009526 = FUN_060094F0 + 0x36);
PROVIDE(DAT_0600952C = FUN_060094F0 + 0x3C);
PROVIDE(DAT_06009532 = FUN_060094F0 + 0x42);
PROVIDE(DAT_06009538 = FUN_060094F0 + 0x48);
PROVIDE(DAT_0600953E = FUN_060094F0 + 0x4E);
PROVIDE(DAT_06009544 = FUN_060094F0 + 0x54);
PROVIDE(DAT_0600954A = FUN_060094F0 + 0x5A);
PROVIDE(DAT_06009550 = FUN_060094F0 + 0x60);
PROVIDE(DAT_06009556 = FUN_060094F0 + 0x66);
PROVIDE(DAT_0600955C = FUN_060094F0 + 0x6C);
PROVIDE(DAT_06009562 = FUN_060094F0 + 0x72);
PROVIDE(DAT_06009568 = FUN_060094F0 + 0x78);
PROVIDE(DAT_0600956E = FUN_060094F0 + 0x7E);
PROVIDE(DAT_06009574 = FUN_060094F0 + 0x84);
PROVIDE(DAT_0600957A = FUN_060094F0 + 0x8A);
PROVIDE(DAT_06009580 = FUN_060094F0 + 0x90);
PROVIDE(DAT_06009586 = FUN_060094F0 + 0x96);
PROVIDE(DAT_0600958C = FUN_060094F0 + 0x9C);
PROVIDE(DAT_06009592 = FUN_060094F0 + 0xA2);
PROVIDE(DAT_060096D4 = FUN_060096B4 + 0x20);
PROVIDE(DAT_06009AA8 = FUN_06009A38 + 0x70);
PROVIDE(DAT_06009AFE = FUN_06009AB2 + 0x4C);
PROVIDE(DAT_06009B54 = FUN_06009B32 + 0x22);
PROVIDE(DAT_06009D40 = FUN_06009D06 + 0x3A);
PROVIDE(DAT_06009FAE = FUN_06009F6E + 0x40);
PROVIDE(DAT_0600A0BA = FUN_0600A08E + 0x2C);
PROVIDE(DAT_0600B8AC = FUN_0600B7A0 + 0x10C);
PROVIDE(DAT_0600B900 = FUN_0600B7A0 + 0x160);
PROVIDE(DAT_0600BA00 = FUN_0600B7A0 + 0x260);
PROVIDE(DAT_0600BBC4 = FUN_0600B7A0 + 0x424);
PROVIDE(DAT_0600BDDE = FUN_0600B7A0 + 0x63E);
PROVIDE(DAT_0600C860 = FUN_0600B7A0 + 0x10C0);
PROVIDE(DAT_0600C868 = FUN_0600B7A0 + 0x10C8);
PROVIDE(DAT_0600C890 = FUN_0600B7A0 + 0x10F0);
PROVIDE(DAT_0600C8B8 = FUN_0600B7A0 + 0x1118);
PROVIDE(DAT_0600C908 = FUN_0600B7A0 + 0x1168);
PROVIDE(DAT_0600C982 = FUN_0600B7A0 + 0x11E2);
PROVIDE(DAT_0600C9C0 = FUN_0600B7A0 + 0x1220);
PROVIDE(DAT_0600C9C4 = FUN_0600B7A0 + 0x1224);
PROVIDE(DAT_0600C9D6 = FUN_0600B7A0 + 0x1236);
PROVIDE(DAT_0600CA38 = FUN_0600B7A0 + 0x1298);
PROVIDE(DAT_0600CA70 = FUN_0600B7A0 + 0x12D0);
PROVIDE(DAT_0600CA8E = FUN_0600B7A0 + 0x12EE);
PROVIDE(DAT_0600CAB8 = FUN_0600B7A0 + 0x1318);
PROVIDE(DAT_0600CB1E = FUN_0600B7A0 + 0x137E);
PROVIDE(DAT_0600CB72 = FUN_0600B7A0 + 0x13D2);
PROVIDE(DAT_0600CB80 = FUN_0600B7A0 + 0x13E0);
PROVIDE(DAT_0600CB90 = FUN_0600B7A0 + 0x13F0);
PROVIDE(DAT_0600CBA2 = FUN_0600B7A0 + 0x1402);
PROVIDE(DAT_0600CBB6 = FUN_0600B7A0 + 0x1416);
PROVIDE(DAT_0600CBBA = FUN_0600B7A0 + 0x141A);
PROVIDE(DAT_0600D30A = FUN_0600B7A0 + 0x1B6A);
PROVIDE(DAT_0600D324 = FUN_0600B7A0 + 0x1B84);
PROVIDE(DAT_0600D342 = FUN_0600B7A0 + 0x1BA2);
PROVIDE(DAT_0600D35E = FUN_0600B7A0 + 0x1BBE);
PROVIDE(DAT_0600D394 = FUN_0600B7A0 + 0x1BF4);
PROVIDE(DAT_0600D3CA = FUN_0600B7A0 + 0x1C2A);
PROVIDE(DAT_0600D3DA = FUN_0600B7A0 + 0x1C3A);
PROVIDE(DAT_0600D424 = FUN_0600B7A0 + 0x1C84);
PROVIDE(DAT_0600D42A = FUN_0600B7A0 + 0x1C8A);
PROVIDE(DAT_0600D436 = FUN_0600B7A0 + 0x1C96);
PROVIDE(DAT_0600D4D0 = FUN_0600B7A0 + 0x1D30);
PROVIDE(DAT_0600D542 = FUN_0600B7A0 + 0x1DA2);
PROVIDE(DAT_0600D5B0 = FUN_0600B7A0 + 0x1E10);
PROVIDE(DAT_0600D744 = FUN_0600B7A0 + 0x1FA4);
PROVIDE(DAT_0600D748 = FUN_0600B7A0 + 0x1FA8);
PROVIDE(DAT_0600D7DE = FUN_0600B7A0 + 0x203E);
PROVIDE(DAT_0600D93E = FUN_0600B7A0 + 0x219E);
PROVIDE(DAT_0600D942 = FUN_0600B7A0 + 0x21A2);
PROVIDE(DAT_0600D968 = FUN_0600B7A0 + 0x21C8);
PROVIDE(DAT_0600D96C = FUN_0600B7A0 + 0x21CC);
PROVIDE(DAT_0600D970 = FUN_0600B7A0 + 0x21D0);
PROVIDE(DAT_0600D996 = FUN_0600B7A0 + 0x21F6);
PROVIDE(DAT_0600D99A = FUN_0600B7A0 + 0x21FA);
PROVIDE(DAT_0600D99E = FUN_0600B7A0 + 0x21FE);
PROVIDE(DAT_0600D9DC = FUN_0600B7A0 + 0x223C);
PROVIDE(DAT_0600DB9A = FUN_0600B7A0 + 0x23FA);
PROVIDE(DAT_0600DC18 = FUN_0600B7A0 + 0x2478);
PROVIDE(DAT_0600DC24 = FUN_0600B7A0 + 0x2484);
PROVIDE(DAT_0600DC38 = FUN_0600B7A0 + 0x2498);
PROVIDE(DAT_0600DCC2 = FUN_0600B7A0 + 0x2522);
PROVIDE(DAT_0600DDAA = FUN_0600B7A0 + 0x260A);
PROVIDE(DAT_0600DDE0 = FUN_0600B7A0 + 0x2640);
PROVIDE(DAT_0600DE4A = FUN_0600B7A0 + 0x26AA);
PROVIDE(DAT_0600DFB0 = FUN_0600B7A0 + 0x2810);
PROVIDE(DAT_0600E048 = FUN_0600B7A0 + 0x28A8);
PROVIDE(DAT_0600E09A = FUN_0600B7A0 + 0x28FA);
PROVIDE(DAT_0600E0A6 = FUN_0600B7A0 + 0x2906);
PROVIDE(DAT_0600E0AC = FUN_0600B7A0 + 0x290C);
PROVIDE(DAT_0600E488 = FUN_0600B7A0 + 0x2CE8);
PROVIDE(DAT_0600E564 = FUN_0600B7A0 + 0x2DC4);
PROVIDE(DAT_0600E57C = FUN_0600B7A0 + 0x2DDC);
PROVIDE(DAT_0600E674 = FUN_0600B7A0 + 0x2ED4);
PROVIDE(DAT_0600E68C = FUN_0600B7A0 + 0x2EEC);
PROVIDE(DAT_0600E6E4 = FUN_0600B7A0 + 0x2F44);
PROVIDE(DAT_0600E7E4 = FUN_0600B7A0 + 0x3044);
PROVIDE(DAT_0600E8A8 = FUN_0600B7A0 + 0x3108);
PROVIDE(DAT_0600E908 = FUN_0600B7A0 + 0x3168);
PROVIDE(DAT_0600E93C = FUN_0600B7A0 + 0x319C);
PROVIDE(DAT_0600E94E = FUN_0600B7A0 + 0x31AE);
PROVIDE(DAT_0600E9B2 = FUN_0600E98A + 0x28);
PROVIDE(DAT_0600EA10 = FUN_0600E9E8 + 0x28);
PROVIDE(DAT_0600EC26 = FUN_0600EA84 + 0x1A2);
PROVIDE(DAT_0600EC58 = FUN_0600EA84 + 0x1D4);
PROVIDE(DAT_0600EC88 = FUN_0600EA84 + 0x204);
PROVIDE(DAT_0600ECB2 = FUN_0600EA84 + 0x22E);
PROVIDE(DAT_0600ED32 = FUN_0600EA84 + 0x2AE);
PROVIDE(DAT_0600ED58 = FUN_0600EA84 + 0x2D4);
PROVIDE(DAT_0600ED88 = FUN_0600EA84 + 0x304);
PROVIDE(DAT_0600EDAA = FUN_0600EA84 + 0x326);
PROVIDE(DAT_0600EDC8 = FUN_0600EA84 + 0x344);
PROVIDE(DAT_0600EEBA = FUN_0600EA84 + 0x436);
PROVIDE(DAT_0600EF06 = FUN_0600EA84 + 0x482);
PROVIDE(DAT_0600EF72 = FUN_0600EA84 + 0x4EE);
PROVIDE(DAT_0600EFCC = FUN_0600EA84 + 0x548);
PROVIDE(DAT_0600F01E = FUN_0600EA84 + 0x59A);
PROVIDE(DAT_0600F058 = FUN_0600EA84 + 0x5D4);
PROVIDE(DAT_0600F0E6 = FUN_0600EA84 + 0x662);
PROVIDE(DAT_0600F16E = FUN_0600EA84 + 0x6EA);
PROVIDE(DAT_0600F28E = FUN_0600EA84 + 0x80A);
PROVIDE(DAT_0600F30E = FUN_0600EA84 + 0x88A);
PROVIDE(DAT_0600F3F6 = FUN_0600EA84 + 0x972);
PROVIDE(DAT_0600F4D4 = FUN_0600EA84 + 0xA50);
PROVIDE(DAT_0600F504 = FUN_0600EA84 + 0xA80);
PROVIDE(DAT_0600F6A6 = FUN_0600EA84 + 0xC22);
PROVIDE(DAT_0600F6AE = FUN_0600EA84 + 0xC2A);
PROVIDE(DAT_0601001A = FUN_0600EA84 + 0x1596);
PROVIDE(DAT_06010040 = FUN_0600EA84 + 0x15BC);
PROVIDE(DAT_060100B8 = FUN_0600EA84 + 0x1634);
PROVIDE(DAT_06010124 = FUN_0600EA84 + 0x16A0);
PROVIDE(DAT_0601014E = FUN_0600EA84 + 0x16CA);
PROVIDE(DAT_060101B4 = FUN_0600EA84 + 0x1730);
PROVIDE(DAT_060101D4 = FUN_0600EA84 + 0x1750);
PROVIDE(DAT_060101EC = FUN_0600EA84 + 0x1768);
PROVIDE(DAT_06010234 = FUN_0600EA84 + 0x17B0);
PROVIDE(DAT_06010312 = FUN_0600EA84 + 0x188E);
PROVIDE(DAT_06010324 = FUN_0600EA84 + 0x18A0);
PROVIDE(DAT_06010354 = FUN_0600EA84 + 0x18D0);
PROVIDE(DAT_06010374 = FUN_0600EA84 + 0x18F0);
PROVIDE(DAT_06010418 = FUN_0600EA84 + 0x1994);
PROVIDE(DAT_06010492 = FUN_0600EA84 + 0x1A0E);
PROVIDE(DAT_060104D0 = FUN_0600EA84 + 0x1A4C);
PROVIDE(DAT_06010526 = FUN_0600EA84 + 0x1AA2);
PROVIDE(DAT_06010550 = FUN_0600EA84 + 0x1ACC);
PROVIDE(DAT_06010594 = FUN_0600EA84 + 0x1B10);
PROVIDE(DAT_06010616 = FUN_0600EA84 + 0x1B92);
PROVIDE(DAT_0601064C = FUN_0600EA84 + 0x1BC8);
PROVIDE(DAT_0601069A = FUN_0600EA84 + 0x1C16);
PROVIDE(DAT_060106DE = FUN_0600EA84 + 0x1C5A);
PROVIDE(DAT_0601070C = FUN_0600EA84 + 0x1C88);
PROVIDE(DAT_06010770 = FUN_0600EA84 + 0x1CEC);
PROVIDE(DAT_06010850 = FUN_0600EA84 + 0x1DCC);
PROVIDE(DAT_0601087A = FUN_0600EA84 + 0x1DF6);
PROVIDE(DAT_060108A8 = FUN_0600EA84 + 0x1E24);
PROVIDE(DAT_06010962 = FUN_0600EA84 + 0x1EDE);
PROVIDE(DAT_06010A80 = FUN_0600EA84 + 0x1FFC);
PROVIDE(DAT_06010AB0 = FUN_0600EA84 + 0x202C);
PROVIDE(DAT_06010AB8 = FUN_0600EA84 + 0x2034);
PROVIDE(DAT_06010AC8 = FUN_0600EA84 + 0x2044);
PROVIDE(DAT_06010AE0 = FUN_0600EA84 + 0x205C);
PROVIDE(DAT_06010AF4 = FUN_0600EA84 + 0x2070);
PROVIDE(DAT_06010B0C = FUN_0600EA84 + 0x2088);
PROVIDE(DAT_06010B24 = FUN_0600EA84 + 0x20A0);
PROVIDE(DAT_06010B40 = FUN_0600EA84 + 0x20BC);
PROVIDE(DAT_06010D6C = FUN_0600EA84 + 0x22E8);
PROVIDE(DAT_06010DB4 = FUN_0600EA84 + 0x2330);
PROVIDE(DAT_06011994 = FUN_0600EA84 + 0x2F10);
PROVIDE(DAT_060119A0 = FUN_0600EA84 + 0x2F1C);
PROVIDE(DAT_060119AC = FUN_0600EA84 + 0x2F28);
PROVIDE(DAT_060119B8 = FUN_0600EA84 + 0x2F34);
PROVIDE(DAT_060119C4 = FUN_0600EA84 + 0x2F40);
PROVIDE(DAT_060119D0 = FUN_0600EA84 + 0x2F4C);
PROVIDE(DAT_060119DC = FUN_0600EA84 + 0x2F58);
PROVIDE(DAT_060119EC = FUN_0600EA84 + 0x2F68);
PROVIDE(DAT_060119F8 = FUN_0600EA84 + 0x2F74);
PROVIDE(DAT_06011A04 = FUN_0600EA84 + 0x2F80);
PROVIDE(DAT_06011A14 = FUN_0600EA84 + 0x2F90);
PROVIDE(DAT_06011A20 = FUN_0600EA84 + 0x2F9C);
PROVIDE(DAT_06011A29 = FUN_0600EA84 + 0x2FA5);
PROVIDE(DAT_06011A50 = FUN_0600EA84 + 0x2FCC);
PROVIDE(DAT_06011A68 = FUN_0600EA84 + 0x2FE4);
PROVIDE(DAT_06011A72 = FUN_0600EA84 + 0x2FEE);
PROVIDE(DAT_06011A76 = FUN_0600EA84 + 0x2FF2);
PROVIDE(DAT_06011A80 = FUN_0600EA84 + 0x2FFC);
PROVIDE(DAT_06011A94 = FUN_0600EA84 + 0x3010);
PROVIDE(DAT_06011AA4 = FUN_0600EA84 + 0x3020);
PROVIDE(DAT_06011AB4 = FUN_0600EA84 + 0x3030);
PROVIDE(DAT_06011AC4 = FUN_0600EA84 + 0x3040);
PROVIDE(DAT_06011ACC = FUN_0600EA84 + 0x3048);
PROVIDE(DAT_06011B14 = FUN_0600EA84 + 0x3090);
PROVIDE(DAT_06011B1C = FUN_0600EA84 + 0x3098);
PROVIDE(DAT_06011B20 = FUN_0600EA84 + 0x309C);
PROVIDE(DAT_06011B24 = FUN_0600EA84 + 0x30A0);
PROVIDE(DAT_06011B28 = FUN_0600EA84 + 0x30A4);
PROVIDE(DAT_06011B2C = FUN_0600EA84 + 0x30A8);
PROVIDE(DAT_06011B30 = FUN_0600EA84 + 0x30AC);
PROVIDE(DAT_06011B54 = FUN_0600EA84 + 0x30D0);
PROVIDE(DAT_06011B58 = FUN_0600EA84 + 0x30D4);
PROVIDE(DAT_06011B5C = FUN_0600EA84 + 0x30D8);
PROVIDE(DAT_06011B84 = FUN_0600EA84 + 0x3100);
PROVIDE(DAT_06011F84 = FUN_0600EA84 + 0x3500);
PROVIDE(DAT_06011F88 = FUN_0600EA84 + 0x3504);
PROVIDE(DAT_06011F89 = FUN_0600EA84 + 0x3505);
PROVIDE(DAT_06011F90 = FUN_0600EA84 + 0x350C);
PROVIDE(DAT_06011F91 = FUN_0600EA84 + 0x350D);
PROVIDE(DAT_06011F94 = FUN_0600EA84 + 0x3510);
PROVIDE(DAT_06011F98 = FUN_0600EA84 + 0x3514);
PROVIDE(DAT_06011F99 = FUN_0600EA84 + 0x3515);
PROVIDE(DAT_06011F9A = FUN_0600EA84 + 0x3516);
PROVIDE(DAT_06011F9B = FUN_0600EA84 + 0x3517);
PROVIDE(DAT_06011F9C = FUN_0600EA84 + 0x3518);
PROVIDE(DAT_06011F9D = FUN_0600EA84 + 0x3519);
PROVIDE(DAT_06011F9F = FUN_0600EA84 + 0x351B);
PROVIDE(DAT_06011FA4 = FUN_0600EA84 + 0x3520);
PROVIDE(DAT_06011FA6 = FUN_0600EA84 + 0x3522);
PROVIDE(DAT_06011FA8 = FUN_0600EA84 + 0x3524);
PROVIDE(DAT_06011FB8 = FUN_0600EA84 + 0x3534);
PROVIDE(DAT_06011FBA = FUN_0600EA84 + 0x3536);
PROVIDE(DAT_06011FBC = FUN_0600EA84 + 0x3538);
PROVIDE(DAT_0601315C = FUN_0600EA84 + 0x46D8);
PROVIDE(DAT_06013168 = FUN_0600EA84 + 0x46E4);
PROVIDE(DAT_06013188 = FUN_0600EA84 + 0x4704);
PROVIDE(DAT_06013190 = FUN_0600EA84 + 0x470C);
PROVIDE(DAT_060131B0 = FUN_0600EA84 + 0x472C);
PROVIDE(DAT_060131B4 = FUN_0600EA84 + 0x4730);
PROVIDE(DAT_060131B8 = FUN_0600EA84 + 0x4734);
PROVIDE(DAT_060131BC = FUN_0600EA84 + 0x4738);
PROVIDE(DAT_060131BE = FUN_0600EA84 + 0x473A);
PROVIDE(DAT_060131C0 = FUN_0600EA84 + 0x473C);
PROVIDE(DAT_060131C4 = FUN_0600EA84 + 0x4740);
PROVIDE(DAT_060131C8 = FUN_0600EA84 + 0x4744);
PROVIDE(DAT_060131CC = FUN_0600EA84 + 0x4748);
PROVIDE(DAT_060131D0 = FUN_0600EA84 + 0x474C);
PROVIDE(DAT_06013200 = FUN_0600EA84 + 0x477C);
PROVIDE(DAT_06013208 = FUN_0600EA84 + 0x4784);
PROVIDE(DAT_06013308 = FUN_0600EA84 + 0x4884);
PROVIDE(DAT_0601330C = FUN_0600EA84 + 0x4888);
PROVIDE(DAT_06013326 = FUN_0600EA84 + 0x48A2);
PROVIDE(DAT_06013328 = FUN_0600EA84 + 0x48A4);
PROVIDE(DAT_0601332C = FUN_0600EA84 + 0x48A8);
PROVIDE(DAT_06013330 = FUN_0600EA84 + 0x48AC);
PROVIDE(DAT_06013358 = FUN_0600EA84 + 0x48D4);
PROVIDE(DAT_0601335C = FUN_0600EA84 + 0x48D8);
PROVIDE(DAT_0601335D = FUN_0600EA84 + 0x48D9);
PROVIDE(DAT_0601335E = FUN_0600EA84 + 0x48DA);
PROVIDE(DAT_0601335F = FUN_0600EA84 + 0x48DB);
PROVIDE(DAT_06013360 = FUN_0600EA84 + 0x48DC);
PROVIDE(DAT_06013361 = FUN_0600EA84 + 0x48DD);
PROVIDE(DAT_06013362 = FUN_0600EA84 + 0x48DE);
PROVIDE(DAT_06013364 = FUN_0600EA84 + 0x48E0);
PROVIDE(DAT_06013365 = FUN_0600EA84 + 0x48E1);
PROVIDE(DAT_06013366 = FUN_0600EA84 + 0x48E2);
PROVIDE(DAT_06013367 = FUN_0600EA84 + 0x48E3);
PROVIDE(DAT_06013368 = FUN_0600EA84 + 0x48E4);
PROVIDE(DAT_06013369 = FUN_0600EA84 + 0x48E5);
PROVIDE(DAT_0601336A = FUN_0600EA84 + 0x48E6);
PROVIDE(DAT_0601336B = FUN_0600EA84 + 0x48E7);
PROVIDE(DAT_0601336C = FUN_0600EA84 + 0x48E8);
PROVIDE(DAT_0601336E = FUN_0600EA84 + 0x48EA);
PROVIDE(DAT_06013370 = FUN_0600EA84 + 0x48EC);
PROVIDE(DAT_06013374 = FUN_0600EA84 + 0x48F0);
PROVIDE(DAT_0601339C = FUN_0600EA84 + 0x4918);
PROVIDE(DAT_060133AC = FUN_0600EA84 + 0x4928);
PROVIDE(DAT_060133B2 = FUN_0600EA84 + 0x492E);
PROVIDE(DAT_060133B4 = FUN_0600EA84 + 0x4930);
PROVIDE(DAT_060133DC = FUN_0600EA84 + 0x4958);
PROVIDE(DAT_060133F6 = FUN_0600EA84 + 0x4972);
PROVIDE(DAT_060133F7 = FUN_0600EA84 + 0x4973);
PROVIDE(DAT_060133F8 = FUN_0600EA84 + 0x4974);
PROVIDE(DAT_060133FA = FUN_0600EA84 + 0x4976);
PROVIDE(DAT_060133FC = FUN_0600EA84 + 0x4978);
PROVIDE(DAT_0601348C = FUN_0600EA84 + 0x4A08);
PROVIDE(DAT_060134B4 = FUN_0600EA84 + 0x4A30);
PROVIDE(DAT_060135B8 = FUN_0600EA84 + 0x4B34);
PROVIDE(DAT_060135BC = FUN_0600EA84 + 0x4B38);
PROVIDE(DAT_060135BD = FUN_0600EA84 + 0x4B39);
PROVIDE(DAT_060135C0 = FUN_0600EA84 + 0x4B3C);
PROVIDE(DAT_060135C4 = FUN_0600EA84 + 0x4B40);
PROVIDE(DAT_060135C8 = FUN_0600EA84 + 0x4B44);
PROVIDE(DAT_060135C9 = FUN_0600EA84 + 0x4B45);
PROVIDE(DAT_060135CA = FUN_0600EA84 + 0x4B46);
PROVIDE(DAT_060135CB = FUN_0600EA84 + 0x4B47);
PROVIDE(DAT_060135CC = FUN_0600EA84 + 0x4B48);
PROVIDE(DAT_060135D0 = FUN_0600EA84 + 0x4B4C);
PROVIDE(DAT_060135E4 = FUN_0600EA84 + 0x4B60);
PROVIDE(DAT_060135E8 = FUN_0600EA84 + 0x4B64);
PROVIDE(DAT_060135EC = FUN_0600EA84 + 0x4B68);
PROVIDE(DAT_060135F0 = FUN_0600EA84 + 0x4B6C);
PROVIDE(DAT_060135F8 = FUN_0600EA84 + 0x4B74);
PROVIDE(DAT_060135FC = FUN_0600EA84 + 0x4B78);
PROVIDE(DAT_06013600 = FUN_0600EA84 + 0x4B7C);
PROVIDE(DAT_06013604 = FUN_0600EA84 + 0x4B80);
PROVIDE(DAT_06013608 = FUN_0600EA84 + 0x4B84);
PROVIDE(DAT_0601360C = FUN_0600EA84 + 0x4B88);
PROVIDE(DAT_06013610 = FUN_0600EA84 + 0x4B8C);
PROVIDE(DAT_06013614 = FUN_0600EA84 + 0x4B90);
PROVIDE(DAT_06013618 = FUN_0600EA84 + 0x4B94);
PROVIDE(DAT_06013619 = FUN_0600EA84 + 0x4B95);
PROVIDE(DAT_0601361A = FUN_0600EA84 + 0x4B96);
PROVIDE(DAT_0601361C = FUN_0600EA84 + 0x4B98);
PROVIDE(DAT_06013620 = FUN_0600EA84 + 0x4B9C);
PROVIDE(DAT_06013628 = FUN_0600EA84 + 0x4BA4);
PROVIDE(DAT_0601362C = FUN_0600EA84 + 0x4BA8);
PROVIDE(DAT_06013630 = FUN_0600EA84 + 0x4BAC);
PROVIDE(DAT_06013634 = FUN_0600EA84 + 0x4BB0);
PROVIDE(DAT_06013640 = FUN_0600EA84 + 0x4BBC);
PROVIDE(DAT_06013641 = FUN_0600EA84 + 0x4BBD);
PROVIDE(DAT_06013642 = FUN_0600EA84 + 0x4BBE);
PROVIDE(DAT_06013643 = FUN_0600EA84 + 0x4BBF);
PROVIDE(DAT_06013644 = FUN_0600EA84 + 0x4BC0);
PROVIDE(DAT_06013646 = FUN_0600EA84 + 0x4BC2);
PROVIDE(DAT_06013647 = FUN_0600EA84 + 0x4BC3);
PROVIDE(DAT_06013648 = FUN_0600EA84 + 0x4BC4);
PROVIDE(DAT_0601364A = FUN_0600EA84 + 0x4BC6);
PROVIDE(DAT_0601364C = FUN_0600EA84 + 0x4BC8);
PROVIDE(DAT_06013650 = FUN_0600EA84 + 0x4BCC);
PROVIDE(DAT_06013654 = FUN_0600EA84 + 0x4BD0);
PROVIDE(DAT_06013658 = FUN_0600EA84 + 0x4BD4);
PROVIDE(DAT_0601365C = FUN_0600EA84 + 0x4BD8);
PROVIDE(DAT_06013660 = FUN_0600EA84 + 0x4BDC);
PROVIDE(DAT_06013664 = FUN_0600EA84 + 0x4BE0);
PROVIDE(DAT_06013668 = FUN_0600EA84 + 0x4BE4);
PROVIDE(DAT_0601366C = FUN_0600EA84 + 0x4BE8);
PROVIDE(DAT_06013670 = FUN_0600EA84 + 0x4BEC);
PROVIDE(DAT_06013674 = FUN_0600EA84 + 0x4BF0);
PROVIDE(DAT_06013678 = FUN_0600EA84 + 0x4BF4);
PROVIDE(DAT_06013679 = FUN_0600EA84 + 0x4BF5);
PROVIDE(DAT_06013688 = FUN_0600EA84 + 0x4C04);
PROVIDE(DAT_0601368C = FUN_0600EA84 + 0x4C08);
PROVIDE(DAT_06013694 = FUN_0600EA84 + 0x4C10);
PROVIDE(DAT_06013698 = FUN_0600EA84 + 0x4C14);
PROVIDE(DAT_0601369C = FUN_0600EA84 + 0x4C18);
PROVIDE(DAT_060136A0 = FUN_0600EA84 + 0x4C1C);
PROVIDE(DAT_060136A4 = FUN_0600EA84 + 0x4C20);
PROVIDE(DAT_060136A8 = FUN_0600EA84 + 0x4C24);
PROVIDE(DAT_060136AC = FUN_0600EA84 + 0x4C28);
PROVIDE(DAT_060136B0 = FUN_0600EA84 + 0x4C2C);
PROVIDE(DAT_060136B4 = FUN_0600EA84 + 0x4C30);
PROVIDE(DAT_060136B8 = FUN_0600EA84 + 0x4C34);
PROVIDE(DAT_060136BC = FUN_0600EA84 + 0x4C38);
PROVIDE(DAT_060136BD = FUN_0600EA84 + 0x4C39);
PROVIDE(DAT_060136BE = FUN_0600EA84 + 0x4C3A);
PROVIDE(DAT_060136BF = FUN_0600EA84 + 0x4C3B);
PROVIDE(DAT_060136C0 = FUN_0600EA84 + 0x4C3C);
PROVIDE(DAT_060136C1 = FUN_0600EA84 + 0x4C3D);
PROVIDE(DAT_060136C2 = FUN_0600EA84 + 0x4C3E);
PROVIDE(DAT_060136C3 = FUN_0600EA84 + 0x4C3F);
PROVIDE(DAT_060136C4 = FUN_0600EA84 + 0x4C40);
PROVIDE(DAT_060136C5 = FUN_0600EA84 + 0x4C41);
PROVIDE(DAT_060136C8 = FUN_0600EA84 + 0x4C44);
PROVIDE(DAT_060136D4 = FUN_0600EA84 + 0x4C50);
PROVIDE(DAT_060136E0 = FUN_0600EA84 + 0x4C5C);
PROVIDE(DAT_060136E4 = FUN_0600EA84 + 0x4C60);
PROVIDE(DAT_060136E8 = FUN_0600EA84 + 0x4C64);
PROVIDE(DAT_060136EC = FUN_0600EA84 + 0x4C68);
PROVIDE(DAT_060136F0 = FUN_0600EA84 + 0x4C6C);
PROVIDE(DAT_060136F4 = FUN_0600EA84 + 0x4C70);
PROVIDE(DAT_06013AF4 = FUN_0600EA84 + 0x5070);
PROVIDE(DAT_06013B78 = FUN_0600EA84 + 0x50F4);
PROVIDE(DAT_06013BB4 = FUN_0600EA84 + 0x5130);
PROVIDE(DAT_06013C78 = FUN_0600EA84 + 0x51F4);
PROVIDE(DAT_06013D20 = FUN_0600EA84 + 0x529C);
PROVIDE(DAT_06013D22 = FUN_0600EA84 + 0x529E);
PROVIDE(DAT_06013D24 = FUN_0600EA84 + 0x52A0);
PROVIDE(DAT_06013D26 = FUN_0600EA84 + 0x52A2);
PROVIDE(DAT_06013D28 = FUN_0600EA84 + 0x52A4);
PROVIDE(DAT_06013DA8 = FUN_0600EA84 + 0x5324);
PROVIDE(DAT_060141A8 = FUN_06014096 + 0x112);
PROVIDE(DAT_060151A8 = FUN_0600EA84 + 0x6724);  /* shadow-zone: runtime 0x060151A8 */
PROVIDE(DAT_060191A8 = FUN_06013FA8 + 0x5200);  /* shadow-zone: runtime 0x060191A8 */
PROVIDE(DAT_0601925C = FUN_06013FB4 + 0x52A8);  /* shadow-zone: runtime 0x0601925C */
PROVIDE(DAT_0601927A = FUN_06013FB4 + 0x52C6);  /* shadow-zone: runtime 0x0601927A */
PROVIDE(DAT_06019476 = FUN_06014096 + 0x53E0);  /* shadow-zone: runtime 0x06019476 */
PROVIDE(DAT_060194E0 = FUN_060142E0 + 0x5200);  /* shadow-zone: runtime 0x060194E0 */
PROVIDE(DAT_060195C8 = FUN_060143C8 + 0x5200);  /* shadow-zone: runtime 0x060195C8 */
PROVIDE(DAT_060196EE = FUN_060144EE + 0x5200);  /* shadow-zone: runtime 0x060196EE */
PROVIDE(DAT_06019788 = FUN_060144EE + 0x529A);  /* shadow-zone: runtime 0x06019788 */
PROVIDE(DAT_06019794 = FUN_060144EE + 0x52A6);  /* shadow-zone: runtime 0x06019794 */
PROVIDE(DAT_060197A0 = FUN_060144EE + 0x52B2);  /* shadow-zone: runtime 0x060197A0 */
PROVIDE(DAT_060197AC = FUN_060144EE + 0x52BE);  /* shadow-zone: runtime 0x060197AC */
PROVIDE(DAT_060197B8 = FUN_060144EE + 0x52CA);  /* shadow-zone: runtime 0x060197B8 */
PROVIDE(DAT_060197C4 = FUN_060144EE + 0x52D6);  /* shadow-zone: runtime 0x060197C4 */
PROVIDE(DAT_060197D0 = FUN_060144EE + 0x52E2);  /* shadow-zone: runtime 0x060197D0 */
PROVIDE(DAT_060197E0 = FUN_060144EE + 0x52F2);  /* shadow-zone: runtime 0x060197E0 */
PROVIDE(DAT_060197EC = FUN_060144EE + 0x52FE);  /* shadow-zone: runtime 0x060197EC */
PROVIDE(DAT_060197F8 = FUN_060144EE + 0x530A);  /* shadow-zone: runtime 0x060197F8 */
PROVIDE(DAT_0601983A = FUN_060144EE + 0x534C);  /* shadow-zone: runtime 0x0601983A */
PROVIDE(DAT_0601987C = FUN_060144EE + 0x538E);  /* shadow-zone: runtime 0x0601987C */
PROVIDE(DAT_060198B6 = FUN_060144EE + 0x53C8);  /* shadow-zone: runtime 0x060198B6 */
PROVIDE(DAT_060198F8 = FUN_060144EE + 0x540A);  /* shadow-zone: runtime 0x060198F8 */
PROVIDE(DAT_0601993A = FUN_060144EE + 0x544C);  /* shadow-zone: runtime 0x0601993A */
PROVIDE(DAT_0601997C = FUN_060144EE + 0x548E);  /* shadow-zone: runtime 0x0601997C */
PROVIDE(DAT_060199BE = FUN_060144EE + 0x54D0);  /* shadow-zone: runtime 0x060199BE */
PROVIDE(DAT_060199E0 = FUN_060144EE + 0x54F2);  /* shadow-zone: runtime 0x060199E0 */
PROVIDE(DAT_06019A00 = FUN_060144EE + 0x5512);  /* shadow-zone: runtime 0x06019A00 */

/* sym_ symbols: external/RAM addresses, absolute (106) */
PROVIDE(sym_00100000 = 0x00100000);
PROVIDE(sym_00200000 = 0x00200000);
PROVIDE(sym_00220000 = 0x00220000);
PROVIDE(sym_00240000 = 0x00240000);
PROVIDE(sym_002C4020 = 0x002C4020);
PROVIDE(sym_002FC000 = 0x002FC000);
PROVIDE(sym_002FE800 = 0x002FE800);
PROVIDE(sym_02000000 = 0x02000000);
PROVIDE(sym_044CFFFF = 0x044CFFFF);
PROVIDE(sym_05A00000 = 0x05A00000);
PROVIDE(sym_05FE0000 = 0x05FE0000);
PROVIDE(sym_06000250 = 0x06000250);
PROVIDE(sym_0600026C = 0x0600026C);
PROVIDE(sym_06000288 = 0x06000288);
PROVIDE(sym_0600029C = 0x0600029C);
PROVIDE(sym_06000300 = 0x06000300);
PROVIDE(sym_06000314 = 0x06000314);
PROVIDE(sym_06000320 = 0x06000320);
PROVIDE(sym_06000340 = 0x06000340);
PROVIDE(sym_06000344 = 0x06000344);
PROVIDE(sym_06000CCC = 0x06000CCC);
PROVIDE(sym_06000CCD = 0x06000CCD);
PROVIDE(sym_06000CCE = 0x06000CCE);
PROVIDE(sym_06002000 = 0x06002000);
PROVIDE(sym_06002F9C = 0x06002F9C);
PROVIDE(sym_06002FA4 = 0x06002FA4);
PROVIDE(sym_06002FB8 = 0x06002FB8);
PROVIDE(sym_06002FBC = 0x06002FBC);
PROVIDE(sym_06002FC8 = 0x06002FC8);
PROVIDE(sym_06002FDC = 0x06002FDC);
PROVIDE(sym_06002FF0 = 0x06002FF0);
PROVIDE(sym_06002FF4 = 0x06002FF4);
PROVIDE(sym_06002FF8 = 0x06002FF8);
PROVIDE(sym_06005100 = 0x06005100);
PROVIDE(sym_06019A20 = 0x06019A20);
PROVIDE(sym_0601B000 = 0x0601B000);
PROVIDE(sym_06028000 = 0x06028000);
PROVIDE(sym_060FFC00 = 0x060FFC00);
PROVIDE(sym_20000000 = 0x20000000);
PROVIDE(sym_20100001 = 0x20100001);
PROVIDE(sym_20100003 = 0x20100003);
PROVIDE(sym_20100005 = 0x20100005);
PROVIDE(sym_2010001F = 0x2010001F);
PROVIDE(sym_20100021 = 0x20100021);
PROVIDE(sym_20100031 = 0x20100031);
PROVIDE(sym_20100033 = 0x20100033);
PROVIDE(sym_20100039 = 0x20100039);
PROVIDE(sym_20100061 = 0x20100061);
PROVIDE(sym_20100063 = 0x20100063);
PROVIDE(sym_20100079 = 0x20100079);
PROVIDE(sym_2010007B = 0x2010007B);
PROVIDE(sym_2010007F = 0x2010007F);
PROVIDE(sym_21000000 = 0x21000000);
PROVIDE(sym_24306033 = 0x24306033);
PROVIDE(sym_25810028 = 0x25810028);
PROVIDE(sym_25818000 = 0x25818000);
PROVIDE(sym_25890008 = 0x25890008);
PROVIDE(sym_2589000C = 0x2589000C);
PROVIDE(sym_25890018 = 0x25890018);
PROVIDE(sym_2589001C = 0x2589001C);
PROVIDE(sym_25890020 = 0x25890020);
PROVIDE(sym_25898000 = 0x25898000);
PROVIDE(sym_25A00000 = 0x25A00000);
PROVIDE(sym_25A00410 = 0x25A00410);
PROVIDE(sym_25A00483 = 0x25A00483);
PROVIDE(sym_25A004E0 = 0x25A004E0);
PROVIDE(sym_25A004E1 = 0x25A004E1);
PROVIDE(sym_25A00504 = 0x25A00504);
PROVIDE(sym_25A00700 = 0x25A00700);
PROVIDE(sym_25A0078C = 0x25A0078C);
PROVIDE(sym_25A0078E = 0x25A0078E);
PROVIDE(sym_25A06F18 = 0x25A06F18);
PROVIDE(sym_25A06F1C = 0x25A06F1C);
PROVIDE(sym_25A0A000 = 0x25A0A000);
PROVIDE(sym_25A0B000 = 0x25A0B000);
PROVIDE(sym_25B00400 = 0x25B00400);
PROVIDE(sym_25C00000 = 0x25C00000);
PROVIDE(sym_25D00000 = 0x25D00000);
PROVIDE(sym_25D00002 = 0x25D00002);
PROVIDE(sym_25D00004 = 0x25D00004);
PROVIDE(sym_25D00006 = 0x25D00006);
PROVIDE(sym_25D00008 = 0x25D00008);
PROVIDE(sym_25E00000 = 0x25E00000);
PROVIDE(sym_25E5F000 = 0x25E5F000);
PROVIDE(sym_25E6C000 = 0x25E6C000);
PROVIDE(sym_25E7FFFE = 0x25E7FFFE);
PROVIDE(sym_25F00002 = 0x25F00002);
PROVIDE(sym_25F00004 = 0x25F00004);
PROVIDE(sym_25F80000 = 0x25F80000);
PROVIDE(sym_25F80110 = 0x25F80110);
PROVIDE(sym_25F80114 = 0x25F80114);
PROVIDE(sym_25F80116 = 0x25F80116);
PROVIDE(sym_25F80118 = 0x25F80118);
PROVIDE(sym_25FE0000 = 0x25FE0000);
PROVIDE(sym_25FE0004 = 0x25FE0004);
PROVIDE(sym_25FE0008 = 0x25FE0008);
PROVIDE(sym_25FE0010 = 0x25FE0010);
PROVIDE(sym_26005100 = 0x26005100);
PROVIDE(sym_260133FC = 0x260133FC);
PROVIDE(sym_260135CC = 0x260135CC);
PROVIDE(sym_FFFFFE10 = 0xFFFFFE10);
PROVIDE(sym_FFFFFE11 = 0xFFFFFE11);
PROVIDE(sym_FFFFFE12 = 0xFFFFFE12);
PROVIDE(sym_FFFFFE16 = 0xFFFFFE16);
PROVIDE(sym_FFFFFE60 = 0xFFFFFE60);
PROVIDE(sym_FFFFFEE2 = 0xFFFFFEE2);
